/* Copyright (c) 2013, The Linux Foundation. All rights reserved.
 *
 * This program is free software; you can redistribute it and/or modify
 * it under the terms of the GNU General Public License version 2 and
 * only version 2 as published by the Free Software Foundation.
 *
 * This program is distributed in the hope that it will be useful,
 * but WITHOUT ANY WARRANTY; without even the implied warranty of
 * MERCHANTABILITY or FITNESS FOR A PARTICULAR PURPOSE.  See the
 * GNU General Public License for more details.
 */

/*---------------------------------------------------------------------------
 * This file is autogenerated file using gcdb parser. Please do not edit it.
 * Update input XML file to add a new entry or update variable in this file
 * VERSION = "1.0"
 *---------------------------------------------------------------------------*/
&mdss_mdp {
	dsi_tc_wsvga_vid: qcom,zte-tc358764xbg-wsvga-video {
		qcom,mdss-dsi-panel-name = "TC358764 video mode dsi panel";
		qcom,mdss-pan-physical-height-dimension = <92>;		
		qcom,mdss-pan-physical-width-dimension = <156>;		
		zte,lcd-proc-panel-name = "zte(TC358764XBG)_1024*600_7Inch";
		zte,default_lcd_enabled;
		qcom,cont-splash-enabled; 
		qcom,mdss-dsi-panel-controller = <&mdss_dsi0>;
		qcom,mdss-dsi-panel-type = "dsi_video_mode";
		qcom,mdss-dsi-panel-destination = "display_1";
		qcom,mdss-dsi-panel-mode-gpio-state = "high";
		qcom,mdss-dsi-panel-frame-rate = <60>;
		qcom,mdss-dsi-virtual-channel-id = <0>;
		qcom,mdss-dsi-stream = <0>;
		qcom,mdss-dsi-panel-width = <1024>;
		qcom,mdss-dsi-panel-height = <600>;
		qcom,mdss-dsi-h-front-porch = <312>;
		qcom,mdss-dsi-h-back-porch = <32>;
		qcom,mdss-dsi-h-pulse-width = <32>;
		qcom,mdss-dsi-h-sync-skew = <0>;
		qcom,mdss-dsi-v-back-porch = <4>;
		qcom,mdss-dsi-v-front-porch = <27>;
		qcom,mdss-dsi-v-pulse-width = <4>;
		qcom,mdss-dsi-h-left-border = <0>;
		qcom,mdss-dsi-h-right-border = <0>;
		qcom,mdss-dsi-v-top-border = <0>;
		qcom,mdss-dsi-v-bottom-border = <0>;
		qcom,mdss-dsi-bpp = <24>;
		qcom,mdss-dsi-color-order = <0>;
		qcom,mdss-dsi-underflow-color = <0xff>;
		qcom,mdss-dsi-border-color = <0>;
		qcom,mdss-dsi-on-command = [
					29 01 00 00 00 00 06 04 05 04 00 00 00
					29 01 00 00 00 00 06 3C 01 04 00 04 00
					29 01 00 00 00 00 06 14 01 04 00 00 00
					29 01 00 00 00 00 06 64 01 03 00 00 00
					29 01 00 00 00 00 06 68 01 03 00 00 00
					29 01 00 00 00 00 06 6C 01 03 00 00 00
					29 01 00 00 00 00 06 70 01 03 00 00 00
					29 01 00 00 00 00 06 34 01 1F 00 00 00
					29 01 00 00 00 00 06 10 02 1F 00 00 00
					29 01 00 00 00 00 06 04 01 01 00 00 00
					29 01 00 00 00 00 06 04 02 01 00 00 00
					29 01 00 00 00 00 06 50 04 20 01 A0 00
          29 01 00 00 00 00 06 54 04 10 00 20 00
					29 01 00 00 00 00 06 5C 04 04 00 17 00
					29 01 00 00 00 00 06 64 04 01 00 00 00
					29 01 00 00 01 00 06 a0 04 06 80 44 00
					29 01 00 00 00 00 06 a0 04 06 80 04 00
					29 01 00 00 00 00 06 04 05 04 00 00 00
					29 01 00 00 00 00 06 9C 04 01 00 00 00
					];
		qcom,mdss-dsi-off-command = [05 01 00 00 32 00 02 28 00
					05 01 00 00 78 00 02 10 00];
		qcom,mdss-dsi-on-command-state = "dsi_lp_mode";
		qcom,mdss-dsi-off-command-state ="dsi_lp_mode";
		qcom,mdss-dsi-h-sync-pulse = <1>;
		qcom,mdss-dsi-traffic-mode = "non_burst_sync_event";
		qcom,mdss-dsi-bllp-eof-power-mode;
		qcom,mdss-dsi-bllp-power-mode;
		qcom,mdss-dsi-lane-0-state;
		qcom,mdss-dsi-lane-1-state;
		qcom,mdss-dsi-lane-2-state;
		qcom,mdss-dsi-lane-3-state;
		qcom,mdss-dsi-panel-timings = [56 14 0C 00 34 38 10 18 0e 03 04 00];
		qcom,mdss-dsi-t-clk-post = <0x05>;
		qcom,mdss-dsi-t-clk-pre = <0x14>;
		qcom,mdss-dsi-bl-min-level = <1>;
		qcom,mdss-dsi-bl-max-level = <31>;
		qcom,mdss-dsi-dma-trigger = "trigger_sw";
		qcom,mdss-dsi-mdp-trigger = "none";
		qcom,mdss-dsi-bl-cmd-gpio =  <&msmgpio 89 0>;
		qcom,mdss-dsi-bl-pmic-control-type = "bl_ctrl_gpio";
	};
};
