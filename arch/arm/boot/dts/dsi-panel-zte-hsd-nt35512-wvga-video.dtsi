/* Copyright (c) 2013, The Linux Foundation. All rights reserved.
 *
 * This program is free software; you can redistribute it and/or modify
 * it under the terms of the GNU General Public License version 2 and
 * only version 2 as published by the Free Software Foundation.
 *
 * This program is distributed in the hope that it will be useful,
 * but WITHOUT ANY WARRANTY; without even the implied warranty of
 * MERCHANTABILITY or FITNESS FOR A PARTICULAR PURPOSE.  See the
 * GNU General Public License for more details.
 */

/*---------------------------------------------------------------------------
 * This file is autogenerated file using gcdb parser. Please do not edit it.
 * Update input XML file to add a new entry or update variable in this file
 * VERSION = "1.0"
 *---------------------------------------------------------------------------*/
&mdss_mdp {
	dsi_hsd_wvga_vid: qcom,zte-hsd-nt35512-wvga-video {
		qcom,mdss-dsi-panel-name = "Lead WVGA HSD NT35512 video mode dsi panel";		
		qcom,mdss-pan-physical-height-dimension = <86>;		
		qcom,mdss-pan-physical-width-dimension = <52>;		
		zte,lcd-proc-panel-name = "zteHSD(NT35512)_480*800_4Inch_800";
		qcom,cont-splash-enabled;
		qcom,mdss-dsi-panel-controller = <&mdss_dsi0>;
		qcom,mdss-dsi-panel-type = "dsi_video_mode";
		qcom,mdss-dsi-panel-destination = "display_1";
		qcom,mdss-dsi-panel-mode-gpio-state = "high";
		qcom,mdss-dsi-panel-framerate = <60>;
		qcom,mdss-dsi-virtual-channel-id = <0>;
		qcom,mdss-dsi-stream = <0>;
		qcom,mdss-dsi-panel-width = <480>;
		qcom,mdss-dsi-panel-height = <800>;
		qcom,mdss-dsi-h-front-porch = <160>;
		qcom,mdss-dsi-h-back-porch = <40>;
		qcom,mdss-dsi-h-pulse-width = <8>;
		qcom,mdss-dsi-h-sync-skew = <0>;
		qcom,mdss-dsi-v-back-porch = <10>;
		qcom,mdss-dsi-v-front-porch = <12>;
		qcom,mdss-dsi-v-pulse-width = <2>;
		qcom,mdss-dsi-h-left-border = <0>;
		qcom,mdss-dsi-h-right-border = <0>;
		qcom,mdss-dsi-v-top-border = <0>;
		qcom,mdss-dsi-v-bottom-border = <0>;
		qcom,mdss-dsi-bpp = <24>;
		qcom,mdss-dsi-color-order = <0>;
		qcom,mdss-dsi-underflow-color = <0xff>;
		qcom,mdss-dsi-border-color = <0>;
		qcom,mdss-dsi-on-command = [
39 01 00 00 00 00 06 F0 55 AA 52 08 01 
39 01 00 00 00 00 04 B0 0D 0D 0D 
39 01 00 00 00 00 04 B6 44 44 44 
39 01 00 00 00 00 04 B1 0D 0D 0D 
39 01 00 00 00 00 04 B7 34 34 34 
39 01 00 00 00 00 04 B2 00 00 00 
39 01 00 00 00 00 04 B8 24 24 24 
39 01 00 00 00 00 02 BF 01 
39 01 00 00 00 00 04 B3 08 08 08 
39 01 00 00 00 00 04 B9 34 34 34 
39 01 00 00 00 00 04 BA 24 24 24 
39 01 00 00 00 00 04 BC 00 80 00 
39 01 00 00 00 00 04 BD 00 80 00 
39 01 00 00 00 00 03 BE 00 84 
39 01 00 00 00 00 35 D1 00 02 00 03 00 06 00 12 00 23 00 52 00 85 00 D9 01 16 01 65 01 9E 01 E8 02 1D 02 1F 02 48 02 76 02 8E 02 A9 02 BA 02 CF 02 DD 02 F0 02 FC 03 0D 03 2C 03 E8 
39 01 00 00 00 00 35 D2 00 02 00 03 00 06 00 12 00 23 00 52 00 85 00 D9 01 16 01 65 01 9E 01 E8 02 1D 02 1F 02 4B 02 76 02 8E 02 A9 02 BA 02 CF 02 DD 02 F0 02 FC 03 0D 03 2C 03 E8 
39 01 00 00 00 00 35 D3 00 02 00 03 00 06 00 12 00 23 00 52 00 85 00 D9 01 16 01 65 01 9E 01 E8 02 1D 02 1F 02 4B 02 76 02 8E 02 A9 02 BA 02 CF 02 DD 02 F0 02 FC 03 0D 03 2C 03 E8 
39 01 00 00 00 00 35 D4 00 02 00 03 00 06 00 12 00 23 00 52 00 85 00 D9 01 16 01 65 01 9E 01 E8 02 1D 02 1F 02 4B 02 76 02 8E 02 A9 02 BA 02 CF 02 DD 02 F0 02 FC 03 0D 03 2C 03 E8 
39 01 00 00 00 00 35 D5 00 02 00 03 00 06 00 12 00 23 00 52 00 85 00 D9 01 16 01 65 01 9E 01 E8 02 1D 02 1F 02 4B 02 76 02 8E 02 A9 02 BA 02 CF 02 DD 02 F0 02 FC 03 0D 03 2C 03 E8 
39 01 00 00 00 00 35 D6 00 02 00 03 00 06 00 12 00 23 00 52 00 85 00 D9 01 16 01 65 01 9E 01 E8 02 1D 02 1F 02 4B 02 76 02 8E 02 A9 02 BA 02 CF 02 DD 02 F0 02 FC 03 0D 03 2C 03 E8 
39 01 00 00 00 00 06 F0 55 AA 52 08 00 
39 01 00 00 00 00 03 B1 FC 00 
39 01 00 00 00 00 02 B5 50 
39 01 00 00 00 00 02 B6 04 
39 01 00 00 00 00 03 B7 71 71 
39 01 00 00 00 00 05 B8 01 05 05 05 
39 01 00 00 00 00 04 BC 02 02 02 
39 01 00 00 00 00 06 C9 D0 02 50 50 50 
39 01 00 00 00 00 02 35 00 
39 01 00 00 00 00 02 3A 77 
05 01 00 00 78 00 02 11 00
05 01 00 00 0a 00 02 29 00
					];
		qcom,mdss-dsi-off-command = [05 01 00 00 32 00 02 28 00
					05 01 00 00 78 00 02 10 00
					23 01 00 00 10 00 02
						b0 04
					23 01 00 00 20 00 02
						b1 01];
		qcom,mdss-dsi-on-command-state = "dsi_lp_mode";
		qcom,mdss-dsi-off-command-state = "dsi_lp_mode";
		qcom,mdss-dsi-h-sync-pulse = <0>;
		qcom,mdss-dsi-traffic-mode = "non_burst_sync_event";
		qcom,mdss-dsi-lane-map = "lane_map_3012";
		qcom,mdss-dsi-bllp-eof-power-mode;
		qcom,mdss-dsi-bllp-power-mode;
		qcom,mdss-dsi-lane-0-state;
		qcom,mdss-dsi-lane-1-state;
		qcom,mdss-dsi-panel-timings = [6B 1A 10 00 3C 42 16 1C 15 03 04 00];
		qcom,mdss-dsi-t-clk-post = <0x04>;
		qcom,mdss-dsi-t-clk-pre = <0x1b>;
		qcom,mdss-dsi-bl-min-level = <1>;
		qcom,mdss-dsi-bl-max-level = <31>;
		qcom,mdss-dsi-dma-trigger = "trigger_sw";
		qcom,mdss-dsi-mdp-trigger = "none";
		qcom,mdss-dsi-bl-cmd-gpio =  <&msmgpio 89 0>;
		qcom,mdss-dsi-bl-pmic-control-type = "bl_ctrl_gpio";
	};
};
