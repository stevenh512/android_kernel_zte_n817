/* Copyright (c) 2013, The Linux Foundation. All rights reserved.
 *
 * This program is free software; you can redistribute it and/or modify
 * it under the terms of the GNU General Public License version 2 and
 * only version 2 as published by the Free Software Foundation.
 *
 * This program is distributed in the hope that it will be useful,
 * but WITHOUT ANY WARRANTY; without even the implied warranty of
 * MERCHANTABILITY or FITNESS FOR A PARTICULAR PURPOSE.  See the
 * GNU General Public License for more details.
 */

/*---------------------------------------------------------------------------
 * This file is autogenerated file using gcdb parser. Please do not edit it.
 * Update input XML file to add a new entry or update variable in this file
 * VERSION = "1.0"
 *---------------------------------------------------------------------------*/
&mdss_mdp {
	dsi_chuangshi_hvga_vid: qcom,zte-chuangshi-hx8357-hvga-video {
		qcom,mdss-dsi-panel-name = "Chuangshi 6clock view HVGA HSD HX8357 video mode dsi panel";		
		qcom,mdss-pan-physical-height-dimension = <73>;		
		qcom,mdss-pan-physical-width-dimension = <49>;		
		zte,lcd-proc-panel-name = "ztechuangshi(HX8357)_320*480_3Inch5_600";
		qcom,cont-splash-enabled;
		qcom,mdss-dsi-panel-controller = <&mdss_dsi0>;
		qcom,mdss-dsi-panel-type = "dsi_video_mode";
		qcom,mdss-dsi-panel-destination = "display_1";
		qcom,mdss-dsi-panel-mode-gpio-state = "high";
		qcom,mdss-dsi-panel-framerate = <60>;
		qcom,mdss-dsi-virtual-channel-id = <0>;
		qcom,mdss-dsi-stream = <0>;
		qcom,mdss-dsi-panel-width = <320>;
		qcom,mdss-dsi-panel-height = <480>;
		qcom,mdss-dsi-h-front-porch = <30>;
		qcom,mdss-dsi-h-back-porch = <30>;
		qcom,mdss-dsi-h-pulse-width = <20>;
		qcom,mdss-dsi-h-sync-skew = <0>;
		qcom,mdss-dsi-v-back-porch = <10>;
		qcom,mdss-dsi-v-front-porch = <10>;
		qcom,mdss-dsi-v-pulse-width = <4>;
		qcom,mdss-dsi-h-left-border = <0>;
		qcom,mdss-dsi-h-right-border = <0>;
		qcom,mdss-dsi-v-top-border = <0>;
		qcom,mdss-dsi-v-bottom-border = <0>;
		qcom,mdss-dsi-bpp = <24>;
		qcom,mdss-dsi-color-order = <0>;
		qcom,mdss-dsi-underflow-color = <0xff>;
		qcom,mdss-dsi-border-color = <0>;
		qcom,mdss-dsi-on-command = [
39 01 00 00 0A 00 04 B9 FF 83 57
39 01 00 00 05 00 02 3A 70
39 01 00 00 00 00 02 CC 05
39 01 00 00 00 00 05 B3 43 00 06 06
39 01 00 00 00 00 02 B6 18
39 01 00 00 00 00 07 B1 00 14 18 18 83 AA
39 01 00 00 00 00 08 B4 02 40 00 2A 2A 0D 4F
39 01 00 00 00 00 11 BA 00 56 D4 00 0A 00 10 32 6E 04 05 9A 14 19 10 40
39 01 00 00 00 00 07 C0 24 24 01 3C 1E 08
39 01 00 00 0A 00 44
    E0 00 00 00 00 03 00 06
    00 13 00 1D 00 33 00 40
    00 4B 00 4D 00 46 00 41
    00 35 00 32 00 29 00 27
    00 03 01 00 00 03 00 06
    00 13 00 1D 00 33 00 40
    00 4B 00 4D 00 46 00 41
    00 35 00 31 00 29 00 27
    00 03 00 00
39 01 00 00 05 00 02 E9 20
39 01 00 00 00 00 02 35 00
05 01 00 00 96 00 02 11 00
05 01 00 00 05 00 02 29 00];
		qcom,mdss-dsi-off-command = [05 01 00 00 32 00 02 28 00
					05 01 00 00 78 00 02 10 00];
		qcom,mdss-dsi-on-command-state = "dsi_lp_mode";
		qcom,mdss-dsi-off-command-state = "dsi_lp_mode";
		qcom,mdss-dsi-h-sync-pulse = <0>;
		qcom,mdss-dsi-traffic-mode = "non_burst_sync_event";
		qcom,mdss-dsi-lane-map = "lane_map_3012";
		qcom,mdss-dsi-bllp-eof-power-mode;
		qcom,mdss-dsi-bllp-power-mode;
		qcom,mdss-dsi-lane-0-state;
		qcom,mdss-dsi-panel-timings = [4D 12 0C 00 32 36 10 16 0F 03 04 00];
		qcom,mdss-dsi-t-clk-post = <0x04>;
		qcom,mdss-dsi-t-clk-pre = <0x1b>;
		qcom,mdss-dsi-bl-min-level = <1>;
		qcom,mdss-dsi-bl-max-level = <31>;
		qcom,mdss-dsi-dma-trigger = "trigger_sw";
		qcom,mdss-dsi-mdp-trigger = "none";
		qcom,mdss-dsi-reset-sequence = <1 20>, <0 20>, <1 50>;
		qcom,mdss-dsi-bl-cmd-gpio =  <&msmgpio 89 0>;
		qcom,mdss-dsi-bl-pmic-control-type = "bl_ctrl_gpio";
	};
};
