/* Copyright (c) 2013, The Linux Foundation. All rights reserved.
 *
 * This program is free software; you can redistribute it and/or modify
 * it under the terms of the GNU General Public License version 2 and
 * only version 2 as published by the Free Software Foundation.
 *
 * This program is distributed in the hope that it will be useful,
 * but WITHOUT ANY WARRANTY; without even the implied warranty of
 * MERCHANTABILITY or FITNESS FOR A PARTICULAR PURPOSE.  See the
 * GNU General Public License for more details.
 */

/*---------------------------------------------------------------------------
 * This file is autogenerated file using gcdb parser. Please do not edit it.
 * Update input XML file to add a new entry or update variable in this file
 * VERSION = "1.0"
 *---------------------------------------------------------------------------*/
&mdss_mdp {
	dsi_tianma_qhd_vid: qcom,zte-tianma-hx8389b-qhd-video {
		qcom,mdss-dsi-panel-name = "tianma qHD hx8389b video mode dsi panel";
		qcom,mdss-pan-physical-height-dimension = <110>;		
		qcom,mdss-pan-physical-width-dimension = <62>;		
		zte,lcd-proc-panel-name = "zte_tianma(hx8389b)_540*960_5Inch5_901";
		qcom,cont-splash-enabled;
		qcom,mdss-dsi-panel-controller = <&mdss_dsi0>;
		qcom,mdss-dsi-panel-type = "dsi_video_mode";
		qcom,mdss-dsi-panel-destination = "display_1";
		qcom,mdss-dsi-panel-framerate = <60>;
		qcom,mdss-dsi-virtual-channel-id = <0>;
		qcom,mdss-dsi-stream = <0>;
		qcom,mdss-dsi-panel-width = <540>;
		qcom,mdss-dsi-panel-height = <960>;
		qcom,mdss-dsi-h-front-porch = <48>;
		qcom,mdss-dsi-h-back-porch = <96>;
		qcom,mdss-dsi-h-pulse-width = <96>;
		qcom,mdss-dsi-h-sync-skew = <0>;
		qcom,mdss-dsi-v-front-porch = <9>;
		qcom,mdss-dsi-v-pulse-width = <3>;
		qcom,mdss-dsi-v-back-porch = <13>;
		qcom,mdss-dsi-h-left-border = <0>;
		qcom,mdss-dsi-h-right-border = <0>;
		qcom,mdss-dsi-v-top-border = <0>;
		qcom,mdss-dsi-v-bottom-border = <0>;
		qcom,mdss-dsi-bpp = <24>;
		qcom,mdss-dsi-color-order = <0>;
		qcom,mdss-dsi-underflow-color = <0xff>;
		qcom,mdss-dsi-border-color = <0>;
		qcom,mdss-dsi-on-command = [
				39 01 00 00 00 00 04
					B9 FF 83 89
				39 01 00 00 00 00 08
					BA 41 93 00
					16 A4 10 18
				39 01 00 00 00 00 02
					CC 02
				39 01 00 00 00 00 04
					DE 05 58 10
				39 01 00 00 00 00 14
					B1 00 00 07
					FE 9A 10 11
					D1 F1 28 30
					3F 3F 42 01
					3A F7 20 80
				39 01 00 00 00 00 08
					B2 00 00 78
					0F 05 3F 80
				39 01 00 00 00 00 19
					b4 80 08 00
					32 10 07 32
					10 02 32 10
					00 27 0a 40
					0B 27 00 4B
					14 53 53 0a
					05
				39 01 00 00 00 00 31
					d5 00 00 00
					00 01 00 00
					00 60 00 99
					88 88 88 88
					23 88 01 88
					67 88 45 01
					23 23 88 88
					88 88 88 99
					88 88 88 54
					88 76 88 10
					88 32 32 10
					88 88 88 88
					88
				39 01 00 00 00 00 23
					E0 01 1B 21
					30 32 3F 2E
					46 07 0D 11
					15 17 13 16
					0F 19 01 1B
					21 30 32 3F
					2E 46 07 0D
					11 15 17 13
					16 0F 19
				39 01 00 00 00 00 05
					B6 00 81 00
					81					
				39 01 00 00 00 00 04
					B7 00 00 50
				05 01 00 00 96 00 02
					11 00
				05 01 00 00 96 00 02
					29 00];
		qcom,mdss-dsi-off-command = [05 01 00 00 0a 00 02 28 00
					05 01 00 00 78 00 02 10 00];
		qcom,mdss-dsi-on-command-state = "dsi_lp_mode";
		qcom,mdss-dsi-off-command-state = "dsi_lp_mode";
		qcom,mdss-dsi-h-sync-pulse = <1>;
		qcom,mdss-dsi-traffic-mode = "burst_mode";
		qcom,mdss-dsi-lane-map = "lane_map_3012";
		qcom,mdss-dsi-bllp-eof-power-mode;
		qcom,mdss-dsi-bllp-power-mode;
		qcom,mdss-dsi-lane-0-state;
		qcom,mdss-dsi-lane-1-state;
		qcom,mdss-dsi-panel-timings = [97 23 17 00 4B 53 1C 27 27 03 04 00];
		qcom,mdss-dsi-t-clk-post = <0x04>;
		qcom,mdss-dsi-t-clk-pre = <0x1b>;
		qcom,mdss-dsi-bl-min-level = <1>;
		qcom,mdss-dsi-bl-max-level = <31>;
		qcom,mdss-dsi-dma-trigger = "trigger_sw";
		qcom,mdss-dsi-mdp-trigger = "none";
		qcom,mdss-dsi-bl-cmd-gpio =  <&msmgpio 89 0>;
		qcom,mdss-dsi-bl-pmic-control-type = "bl_ctrl_gpio";
		qcom,mdss-dsi-reset-sequence = <1 20>, <0 20>, <1 20>;

	};
};
