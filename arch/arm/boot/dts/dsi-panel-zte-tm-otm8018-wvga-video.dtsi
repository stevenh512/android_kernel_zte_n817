/* Copyright (c) 2013, The Linux Foundation. All rights reserved.
 *
 * This program is free software; you can redistribute it and/or modify
 * it under the terms of the GNU General Public License version 2 and
 * only version 2 as published by the Free Software Foundation.
 *
 * This program is distributed in the hope that it will be useful,
 * but WITHOUT ANY WARRANTY; without even the implied warranty of
 * MERCHANTABILITY or FITNESS FOR A PARTICULAR PURPOSE.  See the
 * GNU General Public License for more details.
 */

/*---------------------------------------------------------------------------
 * This file is autogenerated file using gcdb parser. Please do not edit it.
 * Update input XML file to add a new entry or update variable in this file
 * VERSION = "1.0"
 *---------------------------------------------------------------------------*/
&mdss_mdp {
	dsi_tm_wvga_vid: qcom,zte-tm-otm8018-wvga-video {
		qcom,mdss-dsi-panel-name = "TM WVGA TM OTM8018 video mode dsi panel";
		qcom,mdss-pan-physical-height-dimension = <86>;		
		qcom,mdss-pan-physical-width-dimension = <52>;		
		zte,lcd-proc-panel-name = "zteTM(OTM8018)_480*800_4Inch_801";
		zte,default_lcd_enabled;
		qcom,cont-splash-enabled;
		qcom,mdss-dsi-panel-controller = <&mdss_dsi0>;
		qcom,mdss-dsi-panel-type = "dsi_video_mode";
		qcom,mdss-dsi-panel-destination = "display_1";
		qcom,mdss-dsi-panel-mode-gpio-state = "high";
		qcom,mdss-dsi-panel-framerate = <60>;
		qcom,mdss-dsi-virtual-channel-id = <0>;
		qcom,mdss-dsi-stream = <0>;
		qcom,mdss-dsi-panel-width = <480>;
		qcom,mdss-dsi-panel-height = <800>;
		qcom,mdss-dsi-h-front-porch = <160>;
		qcom,mdss-dsi-h-back-porch = <40>;
		qcom,mdss-dsi-h-pulse-width = <8>;
		qcom,mdss-dsi-h-sync-skew = <0>;
		qcom,mdss-dsi-v-back-porch = <10>;
		qcom,mdss-dsi-v-front-porch = <12>;
		qcom,mdss-dsi-v-pulse-width = <2>;
		qcom,mdss-dsi-h-left-border = <0>;
		qcom,mdss-dsi-h-right-border = <0>;
		qcom,mdss-dsi-v-top-border = <0>;
		qcom,mdss-dsi-v-bottom-border = <0>;
		qcom,mdss-dsi-bpp = <24>;
		qcom,mdss-dsi-color-order = <0>;
		qcom,mdss-dsi-underflow-color = <0xff>;
		qcom,mdss-dsi-border-color = <0>;
		qcom,mdss-dsi-on-command = [
					39 01 00 00 00 00 02 00 00
39 01 00 00 00 00 05 FF 80 09 01 01
39 01 00 00 00 00 02 00 80
39 01 00 00 00 00 03 FF 80 09
39 01 00 00 00 00 02 00 80 
39 01 00 00 00 00 02 C4 30
39 01 00 00 00 00 02 00 8A 
39 01 00 00 00 00 02 C4 40
39 01 00 00 00 00 02 00 B4
39 01 00 00 00 00 02 C0 50
39 01 00 00 00 00 02 00 89
39 01 00 00 00 00 02 C4 00
39 01 00 00 00 00 02 00 A2
39 01 00 00 00 00 04 C0 0D 0B 1B
39 01 00 00 00 00 02 00 C9
39 01 00 00 00 00 02 CF 08
39 01 00 00 00 00 02 00 94
39 01 00 00 00 00 02 C5 55
39 01 00 00 00 00 02 00 82
39 01 00 00 00 00 02 C5 A3
39 01 00 00 00 00 02 00 90
39 01 00 00 00 00 03 C5 96 77
39 01 00 00 00 00 02 00 00
39 01 00 00 00 00 03 D8 7F 7F
39 01 00 00 00 00 02 00 00
39 01 00 00 00 00 02 D9 62
39 01 00 00 00 00 02 00 00
39 01 00 00 00 00 11 E1 00 05 0A 0D 06 18 0F 0E 00 04 03 08 0F 26 22 0C
39 01 00 00 00 00 02 00 00
39 01 00 00 00 00 11 E2 00 05 0A 0D 06 18 0F 0E 00 04 03 08 0F 26 22 0C
39 01 00 00 00 00 02 00 00
39 01 00 00 00 00 02 00 00
39 01 00 00 00 00 02 00 81
39 01 00 00 00 00 02 C1 66
39 01 00 00 00 00 02 00 A1
39 01 00 00 00 00 02 C1 08
39 01 00 00 00 00 02 00 81
39 01 00 00 00 00 02 C4 83
39 01 00 00 00 00 02 00 92
39 01 00 00 00 00 02 C5 01
39 01 00 00 00 00 02 00 B1
39 01 00 00 00 00 02 C5 A9
39 01 00 00 00 00 02 00 A6
39 01 00 00 00 00 02 C1 01
39 01 00 00 00 00 02 00 C0
39 01 00 00 00 00 02 C5 00
39 01 00 00 00 00 02 00 8B
39 01 00 00 00 00 02 B0 40
39 01 00 00 00 00 02 00 B2
39 01 00 00 00 00 05 F5 15 00 15 00
39 01 00 00 00 00 02 00 93
39 01 00 00 00 00 02 C5 03
39 01 00 00 00 00 02 00 90
39 01 00 00 00 00 07 C0 00 56 00 00 00 03
39 01 00 00 00 00 02 00 A6
39 01 00 00 00 00 04 C1 01 00 00
39 01 00 00 00 00 02 00 80
39 01 00 00 00 00 07 CE 83 01 11 82 01 11
39 01 00 00 00 00 02 00 A0
39 01 00 00 00 00 0f CE 18 05 03 24 00 11 00 18 04 03 25 00 11 00
39 01 00 00 00 00 02 00 B0
39 01 00 00 00 00 0f CE 18 03 03 26 00 11 00 18 02 03 27 00 11 00
39 01 00 00 00 00 02 00 C0
39 01 00 00 00 00 03 CB 04 04
39 01 00 00 00 00 02 00 C6
39 01 00 00 00 00 04 CB 04 04 04
39 01 00 00 00 00 02 00 D5
39 01 00 00 00 00 03 CB 04 04
39 01 00 00 00 00 02 00 DB
39 01 00 00 00 00 04 CB 04 04 04
39 01 00 00 00 00 02 00 80
39 01 00 00 00 00 03 CC 26 25
39 01 00 00 00 00 02 00 86
39 01 00 00 00 00 04 CC 0C 0A 02
39 01 00 00 00 00 02 00 9A
39 01 00 00 00 00 03 CC 26 25
39 01 00 00 00 00 02 00 A1
39 01 00 00 00 00 04 CC 0B 09 01
39 01 00 00 00 00 02 00 B0
39 01 00 00 00 00 03 CC 25 26
39 01 00 00 00 00 02 00 B6
39 01 00 00 00 00 04 CC 09 0B 01
39 01 00 00 00 00 02 00 CA
39 01 00 00 00 00 03 CC 25 26
39 01 00 00 00 00 02 00 D1
39 01 00 00 00 00 04 CC 0A 0C 02
39 01 00 00 00 00 02 00 A0
39 01 00 00 00 00 02 C1 EA
39 01 00 00 00 00 02 00 A6
39 01 00 00 00 00 04 C1 01 00 00
39 01 00 00 00 00 02 00 C6
39 01 00 00 00 00 02 B0 03
39 01 00 00 00 00 02 00 81 
39 01 00 00 00 00 02 C5 66 
39 01 00 00 00 00 02 00 B6 
39 01 00 00 00 00 02 F5 06
39 01 00 00 00 00 02 00 8B 
39 01 00 00 00 00 02 B0 40
39 01 00 00 00 00 02 00 B1 
39 01 00 00 00 00 02 B0 80
39 01 00 00 00 00 02 00 00
39 01 00 00 00 00 04 FF FF FF FF
05 01 00 00 78 00 02 11 00
05 01 00 00 0a 00 02 29 00
					];
		qcom,mdss-dsi-off-command = [05 01 00 00 32 00 02 28 00
					05 01 00 00 78 00 02 10 00
					23 01 00 00 10 00 02
						b0 04
					23 01 00 00 20 00 02
						b1 01];
		qcom,mdss-dsi-on-command-state = "dsi_lp_mode";
		qcom,mdss-dsi-off-command-state = "dsi_lp_mode";
		qcom,mdss-dsi-h-sync-pulse = <0>;
		qcom,mdss-dsi-traffic-mode = "non_burst_sync_event";
		qcom,mdss-dsi-lane-map = "lane_map_3012";
		qcom,mdss-dsi-bllp-eof-power-mode;
		qcom,mdss-dsi-bllp-power-mode;
		qcom,mdss-dsi-lane-0-state;
		qcom,mdss-dsi-lane-1-state;
		qcom,mdss-dsi-panel-timings = [6B 1A 10 00 3C 42 16 1C 15 03 04 00];
		qcom,mdss-dsi-t-clk-post = <0x04>;
		qcom,mdss-dsi-t-clk-pre = <0x1b>;
		qcom,mdss-dsi-bl-min-level = <1>;
		qcom,mdss-dsi-bl-max-level = <31>;
		qcom,mdss-dsi-dma-trigger = "trigger_sw";
		qcom,mdss-dsi-mdp-trigger = "none";
		qcom,mdss-dsi-bl-cmd-gpio =  <&msmgpio 89 0>;
		qcom,mdss-dsi-bl-pmic-control-type = "bl_ctrl_gpio";
	};
};
