/* Copyright (c) 2013, The Linux Foundation. All rights reserved.
 *
 * This program is free software; you can redistribute it and/or modify
 * it under the terms of the GNU General Public License version 2 and
 * only version 2 as published by the Free Software Foundation.
 *
 * This program is distributed in the hope that it will be useful,
 * but WITHOUT ANY WARRANTY; without even the implied warranty of
 * MERCHANTABILITY or FITNESS FOR A PARTICULAR PURPOSE.  See the
 * GNU General Public License for more details.
 */

/dts-v1/;

/include/ "msm8610-v2.dtsi"
/include/ "msm8610-mtp.dtsi"
/include/ "msm8610-camera-sensor-cdp-mtp.dtsi"
/include/ "zte-msm8610-bonnie.dtsi"

/ {
	model = "ZTE MSM 8610v2 BONNIE";
	compatible = "qcom,msm8610-mtp", "qcom,msm8610", "qcom,mtp";
	qcom,board-id = <101 0>;
};

&pm8110_chg {
	qcom,batt-hot-percentage = <35>;
	qcom,batt-cold-percentage= <70>;
	qcom,ibatmax-ma = <1000>;
	qcom,warm-bat-decidegc = <420>;
};