/* Copyright (c) 2013, The Linux Foundation. All rights reserved.
 *
 * This program is free software; you can redistribute it and/or modify
 * it under the terms of the GNU General Public License version 2 and
 * only version 2 as published by the Free Software Foundation.
 *
 * This program is distributed in the hope that it will be useful,
 * but WITHOUT ANY WARRANTY; without even the implied warranty of
 * MERCHANTABILITY or FITNESS FOR A PARTICULAR PURPOSE.  See the
 * GNU General Public License for more details.
 */

/*---------------------------------------------------------------------------
 * This file is autogenerated file using gcdb parser. Please do not edit it.
 * Update input XML file to add a new entry or update variable in this file
 * VERSION = "1.0"
 *---------------------------------------------------------------------------*/
&mdss_mdp {
	dsi_hx8394a_tm_720p_vid: qcom,mdss_dsi_hx8394a_tm_720p_video {
		qcom,mdss-dsi-panel-name = "zteTM(HX8394A)_720*1280_6.0Inch";
		qcom,cont-splash-enabled;
		//qcom,mdss-pan-physical-height-dimension = <135>;
		//qcom,mdss-pan-physical-width-dimension = <77>;
		zte,lcd-proc-panel-name = "zteTM(HX8394A)_720*1280_6.0Inch";
		qcom,mdss-dsi-panel-controller = <&mdss_dsi0>;
		qcom,mdss-dsi-panel-type = "dsi_video_mode";
		qcom,mdss-dsi-panel-destination = "display_1";
		qcom,mdss-dsi-panel-framerate = <60>;
		qcom,mdss-dsi-virtual-channel-id = <0>;
		qcom,mdss-dsi-stream = <0>;
		qcom,mdss-dsi-panel-width = <720>;
		qcom,mdss-dsi-panel-height = <1280>;
		qcom,mdss-dsi-h-front-porch = <100>;
		qcom,mdss-dsi-h-back-porch = <100>;
		qcom,mdss-dsi-h-pulse-width = <24>;
		qcom,mdss-dsi-h-sync-skew = <0>;
		qcom,mdss-dsi-v-back-porch = <20>;
		qcom,mdss-dsi-v-front-porch = <8>;
		qcom,mdss-dsi-v-pulse-width = <4>;
		qcom,mdss-dsi-h-left-border = <0>;
		qcom,mdss-dsi-h-right-border = <0>;
		qcom,mdss-dsi-v-top-border = <0>;
		qcom,mdss-dsi-v-bottom-border = <0>;
		qcom,mdss-dsi-bpp = <24>;
		qcom,mdss-dsi-color-order = <0>;
		qcom,mdss-dsi-underflow-color = <0xff>;
		qcom,mdss-dsi-border-color = <0>;
		qcom,mdss-dsi-on-command = [
				39 01 00 00 00 00 04 b9
										ff 83 94
				39 01 00 00 00 00 11 ba
										13 82 00 16 
										C5 00 10 FF 
										0F 24 03 21 
										24 25 20 08
				39 01 00 00 00 00 80 c1 
										01 00 08 10 
										18 1F 28 2F 
										36 3F 47 4F 
										57 5F 67 6F 
										76 7E 86 8E 
										96 9E A6 AE 
										B6 BE C6 CE 
										D6 DE E6 EE 
										F8 FF 00 00 
										00 00 00 00 
										00 00 00 00 
										08 10 18 21 
										29 31 37 40 
										48 51 58 60 
										67 70 76 7E 
										86 8E 96 9E 
										A6 AE B6 BE 
										C6 CE D6 DE 
										E6 EE F8 FF 
										00 00 00 00 
										00 00 00 00 
										00 00 08 10 
										18 1F 28 30 
										37 40 48 51 
										59 61 69 72 
										79 81 89 92 
										9A A2 AB B3 
										BB C3 CC D3 
										DB E3 EB F1 
										F8 FF 00 00 
										00 00 00 00 
										00 00 00    
				39 01 00 00 00 00 11 b1 
										01 00 37 87 
										01 11 11 22 
										2A 3F 3F 57 
										02 00 E6 E2
				39 01 00 00 00 00 05 b2 
										00 C8 16 06
				39 01 00 00 00 00 02 c6
										08									
				39 01 00 00 00 00 05 bf 
										06 00 10 04				
				39 01 00 00 00 00 17 b4 
										80 08 32 10 0D 
										32 10 08 22 10 
										08 37 04 4A 11 
										37 04 44 06 5A 
										5A 06	
				39 01 00 00 00 00 35 d5 
										00 00 00 10 0A 
										00 01 33 00 00 
										33 00 23 01 67 
										45 01 23 88 88 
										88 88 88 88 88 
										88 88 88 88 45 
										88 99 54 76 10 
										32 32 10 88 88 
										88 88 88 88 88 
										88 88 88 88 54 
										99 88				
				39 01 00 00 00 00 05 c7 
										00 10 00 10				
				39 01 00 00 00 00 2b e0 
										00 0A 15 33 38 
										3F 26 44 06 0C 
										0F 13 16 14 15 
										10 17 00 0A 15 
										33 38 3F 26 44 
										06 0C 0F 13 16 
										14 15 10 17 09 
										17 08 18 09 17 
										08 18
				39 01 00 00 00 00 03 c0 
										0C 17		
				39 01 00 00 00 00 02 cc 
										09		
				39 01 00 00 00 00 02 d4 
										32					
				39 01 00 00 00 00 02 b6 
										22	
				05 01 00 00 78 00 02 11 00
				05 01 00 00 0a 00 02 29 00];
				
		qcom,mdss-dsi-off-command = [
				//05 01 00 00 0a 00 02 28 00 //panmingdong remove this cmd by himax 20140108
				05 01 00 00 96 00 02 10 00];
		qcom,mdss-dsi-on-command-state = "dsi_lp_mode";
		qcom,mdss-dsi-off-command-state = "dsi_hs_mode";
		qcom,mdss-dsi-h-sync-pulse = <1>;
		qcom,mdss-dsi-traffic-mode = <2>;
		qcom,mdss-dsi-lane-map = <0>;
		qcom,mdss-dsi-bllp-eof-power-mode;
		qcom,mdss-dsi-bllp-power-mode;
		qcom,mdss-dsi-lane-0-state;
		qcom,mdss-dsi-lane-1-state;
		qcom,mdss-dsi-lane-2-state;
		qcom,mdss-dsi-lane-3-state;		
		qcom,mdss-dsi-panel-timings = [77 1c 12 00 40 44 16 1e  17 03 04 00];
		qcom,mdss-dsi-t-clk-post = <0x04>;
		qcom,mdss-dsi-t-clk-pre = <0x1a>;
		qcom,mdss-dsi-bl-min-level = <1>;
		qcom,mdss-dsi-bl-max-level = <31>;
		qcom,mdss-dsi-dma-trigger = <4>;
		qcom,mdss-dsi-mdp-trigger = <0>;
		qcom,mdss-dsi-bl-cmd-gpio =  <&msmgpio 79 0>;
		qcom,mdss-dsi-bl-pmic-control-type = "bl_ctrl_gpio";
		qcom,mdss-dsi-reset-sequence = <1 20>, <0 20>, <1 20>;
		qcom,mdss-pan-physical-width-dimension = <77>;
		qcom,mdss-pan-physical-height-dimension = <135>;
	};
};
