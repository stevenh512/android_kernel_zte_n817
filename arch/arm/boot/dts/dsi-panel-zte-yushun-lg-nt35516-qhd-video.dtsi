/* Copyright (c) 2013, The Linux Foundation. All rights reserved.
 *
 * This program is free software; you can redistribute it and/or modify
 * it under the terms of the GNU General Public License version 2 and
 * only version 2 as published by the Free Software Foundation.
 *
 * This program is distributed in the hope that it will be useful,
 * but WITHOUT ANY WARRANTY; without even the implied warranty of
 * MERCHANTABILITY or FITNESS FOR A PARTICULAR PURPOSE.  See the
 * GNU General Public License for more details.
 */

/*---------------------------------------------------------------------------
 * This file is autogenerated file using gcdb parser. Please do not edit it.
 * Update input XML file to add a new entry or update variable in this file
 * VERSION = "1.0"
 *---------------------------------------------------------------------------*/
&mdss_mdp {
	dsi_yushun_qhd_vid: qcom,zte-lg-nt35516-qhd-video {
		qcom,mdss-dsi-panel-name = "yushun qHD lg nt35516 video mode dsi panel";
		qcom,mdss-pan-physical-height-dimension = <110>;		
		qcom,mdss-pan-physical-width-dimension = <62>;		
		zte,lcd-proc-panel-name = "zteLG(NT35516)_540*960_5Inch_901";
		qcom,cont-splash-enabled;
		qcom,mdss-dsi-panel-controller = <&mdss_dsi0>;
		qcom,mdss-dsi-panel-type = "dsi_video_mode";
		qcom,mdss-dsi-panel-destination = "display_1";
		qcom,mdss-dsi-panel-framerate = <60>;
		qcom,mdss-dsi-virtual-channel-id = <0>;
		qcom,mdss-dsi-stream = <0>;
		qcom,mdss-dsi-panel-width = <540>;
		qcom,mdss-dsi-panel-height = <960>;
		qcom,mdss-dsi-h-front-porch = <48>;
		qcom,mdss-dsi-h-back-porch = <96>;
		qcom,mdss-dsi-h-pulse-width = <96>;
		qcom,mdss-dsi-h-sync-skew = <0>;
		qcom,mdss-dsi-v-front-porch = <9>;
		qcom,mdss-dsi-v-pulse-width = <8>;
		qcom,mdss-dsi-v-back-porch = <13>;
		qcom,mdss-dsi-h-left-border = <0>;
		qcom,mdss-dsi-h-right-border = <0>;
		qcom,mdss-dsi-v-top-border = <0>;
		qcom,mdss-dsi-v-bottom-border = <0>;
		qcom,mdss-dsi-bpp = <24>;
		qcom,mdss-dsi-color-order = <0>;
		qcom,mdss-dsi-underflow-color = <0xff>;
		qcom,mdss-dsi-border-color = <0>;
		qcom,mdss-dsi-on-command = [39 01 00 00 00 00 05 FF AA 55 25 01
39 01 00 00 00 00 24 F2 00 00 4A 0A A8 00 00 00 00 00 00 00 00 00 00 00 00 0B 00 00 00 00 00 00 00 00 00 00 40 01 51 00 01 00 01
39 01 00 00 00 00 08 F3 02 03 07 45 88 D1 0D
39 01 00 00 00 00 06 F0 55 AA 52 08 00
39 01 00 00 00 00 04 B1 FC 00 00
39 01 00 00 00 00 05 B8 01 02 02 02
39 01 00 00 00 00 04 BC 00 00 00
39 01 00 00 00 00 07 C9 63 06 0D 1A 17 00
39 01 00 00 00 00 06 F0 55 AA 52 08 01
39 01 00 00 00 00 04 B0 05 05 05
39 01 00 00 00 00 04 B1 05 05 05
39 01 00 00 00 00 04 B2 01 01 01
39 01 00 00 00 00 04 B3 0D 0D 0D
39 01 00 00 00 00 04 B4 09 09 09
39 01 00 00 00 00 04 B6 44 44 44
39 01 00 00 00 00 04 B7 34 34 34
39 01 00 00 00 00 04 B8 10 10 10
39 01 00 00 00 00 04 B9 26 26 26
39 01 00 00 00 00 04 BA 34 34 34
39 01 00 00 00 00 04 BC 00 B5 00
39 01 00 00 00 00 04 BD 00 D2 00
39 01 00 00 00 00 02 BE 57
39 01 00 00 00 00 03 C0 04 00
39 01 00 00 00 00 02 CA 00
39 01 00 00 00 00 05 D0 06 10 0D 0F
39 01 00 00 00 00 11 D1 00 A7 00 F0 01 18 01 30 01 40 01 5F 01 70 01 9E
39 01 00 00 00 00 11 D2 01 BA 01 E7 02 0A 02 42 02 6F 02 70 02 9B 02 CC
39 01 00 00 00 00 11 D3 02 E8 03 19 03 36 03 5E 03 78 03 97 03 A6 03 B3
39 01 00 00 00 00 05 D4 03 D0 03 CF
39 01 00 00 00 00 11 D5 00 A7 01 23 01 48 01 5F 01 6E 01 8B 01 9B 01 C5
39 01 00 00 00 00 11 D6 01 E0 02 0A 02 2B 02 5F 02 89 02 8A 02 B2 02 E0
39 01 00 00 00 00 11 D7 02 FA 03 28 03 43 03 68 03 81 03 9E 03 AC 03 B8
39 01 00 00 00 00 05 D8 03 D0 03 CF
39 01 00 00 00 00 11 D9 00 A7 00 F0 01 18 01 30 01 40 01 5F 01 70 01 9E
39 01 00 00 00 00 11 DD 01 BA 01 E7 02 0A 02 42 02 6F 02 70 02 9B 02 CC
39 01 00 00 00 00 11 DE 02 E8 03 19 03 36 03 5E 03 78 03 97 03 A6 03 B3
39 01 00 00 00 00 05 DF 03 D0 03 CF
39 01 00 00 00 00 11 E0 00 A7 01 23 01 48 01 5F 01 6E 01 8B 01 9B 01 C5
39 01 00 00 00 00 11 E1 01 E0 02 0A 02 2B 02 5F 02 89 02 8A 02 B2 02 E0
39 01 00 00 00 00 11 E2 02 FA 03 28 03 43 03 68 03 81 03 9E 03 AC 03 B8
39 01 00 00 00 00 05 E3 03 D0 03 CF
39 01 00 00 00 00 11 E4 00 A7 00 F0 01 18 01 30 01 40 01 5F 01 70 01 9E
39 01 00 00 00 00 11 E5 01 BA 01 E7 02 0A 02 42 02 6F 02 70 02 9B 02 CC
39 01 00 00 00 00 11 E6 02 E8 03 19 03 36 03 5E 03 78 03 97 03 A6 03 B3
39 01 00 00 00 00 05 E7 03 D0 03 CF
39 01 00 00 00 00 11 E8 00 A7 01 23 01 48 01 5F 01 6E 01 8B 01 9B 01 C5
39 01 00 00 00 00 11 E9 01 E0 02 0A 02 2B 02 5F 02 89 02 8A 02 B2 02 E0
39 01 00 00 00 00 11 EA 02 FA 03 28 03 43 03 68 03 81 03 9E 03 AC 03 B8
39 01 00 00 00 00 05 EB 03 D0 03 CF
39 01 00 00 00 00 02 3A 77
05 01 00 00 78 00 02 11 00
05 01 00 00 0A 00 02 29 00];
		qcom,mdss-dsi-off-command = [05 01 00 00 0a 00 02 28 00
					05 01 00 00 78 00 02 10 00];
		qcom,mdss-dsi-on-command-state = "dsi_lp_mode";
		qcom,mdss-dsi-off-command-state = "dsi_lp_mode";
		qcom,mdss-dsi-h-sync-pulse = <1>;
		qcom,mdss-dsi-traffic-mode = "burst_mode";
		qcom,mdss-dsi-lane-map = "lane_map_3012";
		qcom,mdss-dsi-bllp-eof-power-mode;
		qcom,mdss-dsi-bllp-power-mode;
		qcom,mdss-dsi-lane-0-state;
		qcom,mdss-dsi-lane-1-state;
		qcom,mdss-dsi-panel-timings = [97 23 17 00 4B 53 1C 27 27 03 04 00];
		qcom,mdss-dsi-t-clk-post = <0x04>;
		qcom,mdss-dsi-t-clk-pre = <0x1b>;
		qcom,mdss-dsi-bl-min-level = <1>;
		qcom,mdss-dsi-bl-max-level = <31>;
		qcom,mdss-dsi-dma-trigger = "trigger_sw";
		qcom,mdss-dsi-mdp-trigger = "none";
		qcom,mdss-dsi-bl-cmd-gpio =  <&msmgpio 89 0>;
		qcom,mdss-dsi-bl-pmic-control-type = "bl_ctrl_gpio";
		qcom,mdss-dsi-reset-sequence = <1 20>, <0 20>, <1 20>;

	};
};
