/* Copyright (c) 2013, The Linux Foundation. All rights reserved.
 *
 * This program is free software; you can redistribute it and/or modify
 * it under the terms of the GNU General Public License version 2 and
 * only version 2 as published by the Free Software Foundation.
 *
 * This program is distributed in the hope that it will be useful,
 * but WITHOUT ANY WARRANTY; without even the implied warranty of
 * MERCHANTABILITY or FITNESS FOR A PARTICULAR PURPOSE.  See the
 * GNU General Public License for more details.
 */

/*---------------------------------------------------------------------------
 * This file is autogenerated file using gcdb parser. Please do not edit it.
 * Update input XML file to add a new entry or update variable in this file
 * VERSION = "1.0"
 *---------------------------------------------------------------------------*/
&mdss_mdp {
	dsi_lead_wvga_vid: qcom,zte-lead-ili9806e-wvga-video{
		qcom,mdss-dsi-panel-name = "lead_cpt ili9806e video mode dsi panel";
		qcom,mdss-pan-physical-height-dimension = <86>;		
		qcom,mdss-pan-physical-width-dimension = <52>;		
		zte,lcd-proc-panel-name = "zteLEAD(ILI9806E)_480*800_4Inch_803";
		qcom,cont-splash-enabled;
		qcom,mdss-dsi-panel-controller = <&mdss_dsi0>;
		qcom,mdss-dsi-panel-type = "dsi_video_mode";
		qcom,mdss-dsi-panel-destination = "display_1";
		//qcom,mdss-dsi-panel-mode-gpio-state = "high";
		qcom,mdss-dsi-panel-framerate = <60>;
		qcom,mdss-dsi-virtual-channel-id = <0>;
		qcom,mdss-dsi-stream = <0>;
		qcom,mdss-dsi-panel-width = <480>;
		qcom,mdss-dsi-panel-height = <800>;
		qcom,mdss-dsi-h-front-porch = <80>;
		qcom,mdss-dsi-h-back-porch = <80>;
		qcom,mdss-dsi-h-pulse-width = <40>;
		qcom,mdss-dsi-h-sync-skew = <0>;
		qcom,mdss-dsi-v-front-porch = <8>;
		qcom,mdss-dsi-v-back-porch = <5>;
		qcom,mdss-dsi-v-pulse-width = <6>;
		qcom,mdss-dsi-h-left-border = <0>;
		qcom,mdss-dsi-h-right-border = <0>;
		qcom,mdss-dsi-v-top-border = <0>;
		qcom,mdss-dsi-v-bottom-border = <0>;
		qcom,mdss-dsi-bpp = <24>;
		qcom,mdss-dsi-color-order = <0>;
		qcom,mdss-dsi-underflow-color = <0xff>;
		qcom,mdss-dsi-border-color = <0>;
		qcom,mdss-dsi-on-command = [
	   39 01 00 00 00 00 06 FF FF 98 06 04 01 

            39 01 00 00 00 00 02 30 02 

            39 01 00 00 00 00 02 31 00 

            39 01 00 00 00 00 02 40 15 

            39 01 00 00 00 00 02 41 44 

            39 01 00 00 00 00 02 42 02 

            39 01 00 00 00 00 02 43 09 

            39 01 00 00 00 00 02 44 06 

            39 01 00 00 00 00 02 50 88 

            39 01 00 00 00 00 02 51 88 

            39 01 00 00 00 00 02 52 00 

            39 01 00 00 00 00 02 53 4F 

            39 01 00 00 00 00 02 57 50 

            39 01 00 00 00 00 02 60 07 

            39 01 00 00 00 00 02 61 00 

            39 01 00 00 00 00 02 62 08 

            39 01 00 00 00 00 02 63 00 

            39 01 00 00 00 00 02 A0 00 

            39 01 00 00 00 00 02 A1 07 

            39 01 00 00 00 00 02 A2 11 

            39 01 00 00 00 00 02 A3 12 

            39 01 00 00 00 00 02 A4 0A 

            39 01 00 00 00 00 02 A5 18 

            39 01 00 00 00 00 02 A6 08 

            39 01 00 00 00 00 02 A7 08 

            39 01 00 00 00 00 02 A8 04 

            39 01 00 00 00 00 02 A9 0A 

            39 01 00 00 00 00 02 AA 08 

            39 01 00 00 00 00 02 AB 03 

            39 01 00 00 00 00 02 AC 0E 

            39 01 00 00 00 00 02 AD 2E 

            39 01 00 00 00 00 02 AE 29 

            39 01 00 00 00 00 02 AF 00 

            39 01 00 00 00 00 02 C0 00 

            39 01 00 00 00 00 02 C1 08

            39 01 00 00 00 00 02 C2 13 

            39 01 00 00 00 00 02 C3 0F 

            39 01 00 00 00 00 02 C4 09 

            39 01 00 00 00 00 02 C5 16 

            39 01 00 00 00 00 02 C6 0B 

            39 01 00 00 00 00 02 C7 09 

            39 01 00 00 00 00 02 C8 03 

            39 01 00 00 00 00 02 C9 06 

            39 01 00 00 00 00 02 CA 05

            39 01 00 00 00 00 02 CB 04 

            39 01 00 00 00 00 02 CC 0C 

            39 01 00 00 00 00 02 CD 2D 

            39 01 00 00 00 00 02 CE 29 

            39 01 00 00 00 00 02 CF 00 

            39 01 00 00 00 00 06 FF FF 98 06 04 06 

            39 01 00 00 00 00 02 00 21 

            39 01 00 00 00 00 02 01 06 

            39 01 00 00 00 00 02 02 00 

            39 01 00 00 00 00 02 03 00 

            39 01 00 00 00 00 02 04 01 

            39 01 00 00 00 00 02 05 05 

            39 01 00 00 00 00 02 06 98 

            39 01 00 00 00 00 02 07 02 

            39 01 00 00 00 00 02 08 05 

            39 01 00 00 00 00 02 09 00 

            39 01 00 00 00 00 02 0A 00 

            39 01 00 00 00 00 02 0B 00 

            39 01 00 00 00 00 02 0C 01 

            39 01 00 00 00 00 02 0D 01 

            39 01 00 00 00 00 02 0E 00 

            39 01 00 00 00 00 02 0F 00 

            39 01 00 00 00 00 02 10 77 

            39 01 00 00 00 00 02 11 F4 

            39 01 00 00 00 00 02 12 00 

            39 01 00 00 00 00 02 13 00 

            39 01 00 00 00 00 02 14 00 

            39 01 00 00 00 00 02 15 C0 

            39 01 00 00 00 00 02 16 08 

            39 01 00 00 00 00 02 17 00 

            39 01 00 00 00 00 02 18 00 

            39 01 00 00 00 00 02 19 00 

            39 01 00 00 00 00 02 1A 00 

            39 01 00 00 00 00 02 1B 00 

            39 01 00 00 00 00 02 1C 00 

            39 01 00 00 00 00 02 1D 00 

            39 01 00 00 00 00 02 20 01 

            39 01 00 00 00 00 02 21 23 

            39 01 00 00 00 00 02 22 45 

            39 01 00 00 00 00 02 23 67 

            39 01 00 00 00 00 02 24 01 

            39 01 00 00 00 00 02 25 23 

            39 01 00 00 00 00 02 26 45 

            39 01 00 00 00 00 02 27 67 

            39 01 00 00 00 00 02 30 01 

            39 01 00 00 00 00 02 31 22 

            39 01 00 00 00 00 02 32 11 

            39 01 00 00 00 00 02 33 00 

            39 01 00 00 00 00 02 34 86 

            39 01 00 00 00 00 02 35 68 

            39 01 00 00 00 00 02 36 22 

            39 01 00 00 00 00 02 37 22 

            39 01 00 00 00 00 02 38 DA 

            39 01 00 00 00 00 02 39 CB 

            39 01 00 00 00 00 02 3A BC 

            39 01 00 00 00 00 02 3B AD 

            39 01 00 00 00 00 02 3C 22 

            39 01 00 00 00 00 02 3D 22 

            39 01 00 00 00 00 02 3E 22 

            39 01 00 00 00 00 02 3F 22 

            39 01 00 00 00 00 02 40 22 


            39 01 00 00 00 00 06 FF FF 98 06 04 07 
      
            39 01 00 00 00 00 02 18 1D 


            39 01 00 00 00 00 06 FF FF 98 06 04 00 

            05 01 00 00 78 00 02 11 00 
            05 01 00 00 05 00 02 29 00];
		qcom,mdss-dsi-off-command = [
		05 01 00 00 0a 00 02 28 00
		05 01 00 00 78 00 02 10 00];
		qcom,mdss-dsi-on-command-state = "dsi_lp_mode";
		qcom,mdss-dsi-off-command-state = "dsi_hs_mode";
		qcom,mdss-dsi-h-sync-pulse = <1>;
		//qcom,mdss-dsi-traffic-mode = "burst_mode";
		qcom,mdss-dsi-lane-map = "lane_map_3012";
		qcom,mdss-dsi-bllp-eof-power-mode;
		qcom,mdss-dsi-bllp-power-mode;
		qcom,mdss-dsi-lane-0-state;
		qcom,mdss-dsi-lane-1-state;
		qcom,mdss-dsi-panel-timings = [6E 18 10 00 3C 40 14 1C 12 03 04 00];
		qcom,mdss-dsi-t-clk-post = <0x04>;
		qcom,mdss-dsi-t-clk-pre = <0x1d>;
		qcom,mdss-dsi-bl-min-level = <1>;
		qcom,mdss-dsi-bl-max-level = <31>;
		qcom,mdss-dsi-dma-trigger = "trigger_sw";
		qcom,mdss-dsi-mdp-trigger = "none";
		qcom,mdss-dsi-reset-sequence = <1 20>, <0 2>, <1 20>;
		qcom,mdss-dsi-bl-cmd-gpio =  <&msmgpio 89 0>;
		qcom,mdss-dsi-bl-pmic-control-type = "bl_ctrl_gpio";
	};
};
