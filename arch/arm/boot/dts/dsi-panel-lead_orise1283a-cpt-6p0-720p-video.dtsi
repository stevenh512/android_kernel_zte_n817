/* Copyright (c) 2012, Code Aurora Forum. All rights reserved.
 *
 * This program is free software; you can redistribute it and/or modify
 * it under the terms of the GNU General Public License version 2 and
 * only version 2 as published by the Free Software Foundation.
 *
 * This program is distributed in the hope that it will be useful,
 * but WITHOUT ANY WARRANTY; without even the implied warranty of
 * MERCHANTABILITY or FITNESS FOR A PARTICULAR PURPOSE.  See the
 * GNU General Public License for more details.
 */

/*---------------------------------------------------------------------------
 * This file is autogenerated file using gcdb parser. Please do not edit it.
 * Update input XML file to add a new entry or update variable in this file
 * VERSION = "1.0"
 *---------------------------------------------------------------------------*/
&mdss_mdp {

	dsi_lead_wsvga_vid: qcom,mdss-dsi-lead-orise1283a {

		qcom,mdss-dsi-panel-name = "zteLEAD_CPT(OTM1283A)_720*1280_6.0Inch";
		qcom,cont-splash-enabled;
		//zte,lcd-product = <101>;
		qcom,mdss-pan-physical-height-dimension = <135>;
		qcom,mdss-pan-physical-width-dimension = <77>;
		zte,lcd-proc-panel-name = "zteLEAD_CPT(OTM1283A)_720*1280_6.0Inch";
		qcom,mdss-dsi-panel-controller = <&mdss_dsi0>;
		qcom,mdss-dsi-panel-type = "dsi_video_mode";
		qcom,mdss-dsi-panel-destination = "display_1";
		qcom,mdss-dsi-panel-framerate = <60>;
		qcom,mdss-dsi-virtual-channel-id = <0>;
		qcom,mdss-dsi-stream = <0>;
		qcom,mdss-dsi-panel-width = <720>;
		qcom,mdss-dsi-panel-height = <1280>;
		qcom,mdss-dsi-h-front-porch = <86>;
		qcom,mdss-dsi-h-back-porch = <80>;
		qcom,mdss-dsi-h-pulse-width = <4>;
		qcom,mdss-dsi-h-sync-skew = <0>;
		qcom,mdss-dsi-v-back-porch = <15>;
		qcom,mdss-dsi-v-front-porch = <16>;
		qcom,mdss-dsi-v-pulse-width = <4>;
		qcom,mdss-dsi-h-left-border = <0>;
		qcom,mdss-dsi-h-right-border = <0>;
		qcom,mdss-dsi-v-top-border = <0>;
		qcom,mdss-dsi-v-bottom-border = <0>;
		qcom,mdss-dsi-bpp = <24>;
		qcom,mdss-dsi-color-order = <0>;
		qcom,mdss-dsi-underflow-color = <0xff>;
		qcom,mdss-dsi-border-color = <0>;		
		qcom,mdss-dsi-off-command = [05 01 00 00 32 00 02 28 00
					05 01 00 00 78 00 02 10 00];
		qcom,mdss-dsi-on-command-state = "dsi_lp_mode";
		qcom,mdss-dsi-off-command-state = "dsi_hs_mode";
		qcom,mdss-dsi-h-sync-pulse = <1>;
		qcom,mdss-dsi-traffic-mode = "burst_mode";//default 0
		qcom,mdss-dsi-lane-map = <0>;
		qcom,mdss-dsi-bllp-eof-power-mode;
		qcom,mdss-dsi-bllp-power-mode;
		qcom,mdss-dsi-lane-0-state;
		qcom,mdss-dsi-lane-1-state;
		qcom,mdss-dsi-lane-2-state;
		qcom,mdss-dsi-lane-3-state;
		//qcom,mdss-dsi-panel-timings = [b0 23 1b 00 94 93 1e 25  15 03 04 00];
		qcom,mdss-dsi-panel-timings = [73 1a 10 00 3e 42 16 1e 15 03 04 a0];
		qcom,mdss-dsi-t-clk-post = <0x04>;
		qcom,mdss-dsi-t-clk-pre = <0x18>;
		qcom,mdss-dsi-bl-min-level = <1>;
		qcom,mdss-dsi-bl-max-level = <28>;
		qcom,mdss-dsi-dma-trigger = "trigger_sw";
		qcom,mdss-dsi-mdp-trigger = "none";
		qcom,mdss-dsi-bl-cmd-gpio =  <&msmgpio 79 0>;
		qcom,mdss-dsi-bl-pmic-control-type = "bl_ctrl_gpio";
		qcom,mdss-dsi-reset-sequence = <1 20>, <0 20>, <1 20>;

		qcom,mdss-dsi-on-command = [
39 01 00 00 00 00 02 00  00
39 01 00 00 00 00 04 ff  12 83  01 
39 01 00 00 00 00 02 00  80
39 01 00 00 00 00 03 ff  12 83 
39 01 00 00 00 00 02 00  92	            
39 01 00 00 00 00 03 ff  30 02    //MIPI 4lane
39 01 00 00 00 00 02 00  B9
39 01 00 00 00 00 02 B0  51
39 01 00 00 00 00 02 00  c6
39 01 00 00 00 00 02 B0  03
39 01 00 00 00 00 02 00  80
39 01 00 00 00 00 0A c0  00 64  00  10  10  00  64  10  10 
39 01 00 00 00 00 02 00  90
39 01 00 00 00 00 07 c0  00 5c  00  01  00  04 
39 01 00 00 00 00 02 00  a4
39 01 00 00 00 00 02 c0  22
39 01 00 00 00 00 02 00  b3
39 01 00 00 00 00 03 c0  00 50 
39 01 00 00 00 00 02 00  81
39 01 00 00 00 00 02 c1  66
39 01 00 00 00 00 02 00  80
39 01 00 00 00 00 02 c4  30       //source to gnd
39 01 00 00 00 00 02 00  8b
39 01 00 00 00 00 02 c4  00       //source to gnd
39 01 00 00 00 00 02 00  81
39 01 00 00 00 00 02 c4  82
39 01 00 00 00 00 02 00  82
39 01 00 00 00 00 02 C4  02
39 01 00 00 00 00 02 00  90
39 01 00 00 00 00 02 c4  52       // 49-> 52
39 01 00 00 00 00 02 00  a0
39 01 00 00 00 00 0F c4  05 10  06  02  05  15  10  05  10  07  02  05  15  10 
39 01 00 00 00 00 02 00  b0
39 01 00 00 00 00 03 c4  00 00 
39 01 00 00 00 00 02 00  91
39 01 00 00 00 00 03 c5  46 40 
39 01 00 00 00 00 02 00  b0
39 01 00 00 00 00 03 c5  04 38 
39 01 00 00 00 00 02 00  b4         //VGLO1/2 Pull low setting
39 01 00 00 00 00 02 c5  c0		      //
39 01 00 00 00 00 02 00  b2         //C31 cap. not remove
39 01 00 00 00 00 02 c5  40
39 01 00 00 00 00 02 00  b5
39 01 00 00 00 00 07 c5  3f ff  ff  3f  ff  ff 
39 01 00 00 00 00 02 00  bb
39 01 00 00 00 00 02 c5  80
39 01 00 00 00 00 02 00  90
39 01 00 00 00 00 05 f5  02 11  02  11 
39 01 00 00 00 00 02 00  90
39 01 00 00 00 00 02 c5  50
39 01 00 00 00 00 02 00  94
39 01 00 00 00 00 02 c5  66
39 01 00 00 00 00 02 00  b2             //VGLO1
39 01 00 00 00 00 03 f5  00 00 
39 01 00 00 00 00 02 00  b4             //VGLO1_S
39 01 00 00 00 00 03 f5  00 00 
39 01 00 00 00 00 02 00  b6             //VGLO2
39 01 00 00 00 00 03 f5  00 00 
39 01 00 00 00 00 02 00  b8             //VGLO2_S
39 01 00 00 00 00 03 f5  00 00 
39 01 00 00 00 00 02 00  94             //VCL on           
39 01 00 00 00 00 02 F5  02 
39 01 00 00 00 00 02 00  BA             //VSP on           
39 01 00 00 00 00 02 F5  03 
39 01 00 00 00 00 02 00  c3            
39 01 00 00 00 00 02 f5  81             //GVDD 
39 01 00 00 00 00 02 00  B1 
39 01 00 00 00 00 02 c6  05             //PWM rate set 22KHZ
39 01 00 00 00 00 02 00  80
39 01 00 00 00 00 0C cb  00 00  00  00  00  00  00  00  00  00  00 
39 01 00 00 00 00 02 00  90
39 01 00 00 00 00 10 cb  00 00  00  00  00  00  00  00  00  00  00  00  00  00  00 
39 01 00 00 00 00 02 00  a0
39 01 00 00 00 00 10 cb  00 00  00  00  00  00  00  00  00  00  00  00  00  00  00 
39 01 00 00 00 00 02 00  b0
39 01 00 00 00 00 10 cb  00 00  00  00  00  00  00  00  00  00  00  00  00  00  00 
39 01 00 00 00 00 02 00  c0
39 01 00 00 00 00 10 cb  05 05  05  05  05  00  00  00  00  00  00  00  00  00  00 
39 01 00 00 00 00 02 00  d0
39 01 00 00 00 00 10 cb  ff ff  ff  00  05  05  05  05  05  05  05  05  00  00  00 
39 01 00 00 00 00 02 00  e0
39 01 00 00 00 00 0F cb  00 00  00  00  00  00  00  ff  ff  ff  00  05  05  05 
39 01 00 00 00 00 02 00  f0
39 01 00 00 00 00 0C cb  ff ff  ff  ff  ff  ff  ff  ff  ff  ff  ff 
39 01 00 00 00 00 02 00  80
39 01 00 00 00 00 10 cc  02 0a  0c  0e  10  00  00  00  00  00  00  00  00  00  00 
39 01 00 00 00 00 02 00  90
39 01 00 00 00 00 10 cc  00 00  00  00  2e  2d  06  01  09  0b  0d  0f  00  00  00 
39 01 00 00 00 00 02 00  a0
39 01 00 00 00 00 0F cc  00 00  00  00  00  00  00  00  00  00  00  2e  2d  05 
39 01 00 00 00 00 02 00  b0
39 01 00 00 00 00 10 cc  05 0f  0d  0b  09  00  00  00  00  00  00  00  00  00  00 
39 01 00 00 00 00 02 00  c0
39 01 00 00 00 00 10 cc  00 00  00  00  2d  2e  01  06  10  0e  0c  0a  00  00  00 
39 01 00 00 00 00 02 00  d0
39 01 00 00 00 00 0F cc  00 00  00  00  00  00  00  00  00  00  00  2d  2e  02 
39 01 00 00 00 00 02 00  80
39 01 00 00 00 00 0D ce  87 03  10  86  03  10  00  00  00  00  00  00 
39 01 00 00 00 00 02 00  90
39 01 00 00 00 00 0F ce  35 01  10  35  02  10  00  00  00  00  00  00  00  00 
39 01 00 00 00 00 02 00  a0
39 01 00 00 00 00 0F ce  38 03  04  f8  00  10  00  38  02  04  f9  00  10  00 
39 01 00 00 00 00 02 00  b0
39 01 00 00 00 00 0F ce  38 01  04  fa  00  10  00  38  00  04  fb  00  10  00 
39 01 00 00 00 00 02 00  c0
39 01 00 00 00 00 0F ce  30 00  04  fc  00  10  00  30  01  04  fd  00  10  00 
39 01 00 00 00 00 02 00  d0
39 01 00 00 00 00 0F ce  30 02  04  fe  00  10  00  30  03  04  ff  00  10  00 
39 01 00 00 00 00 02 00  80
39 01 00 00 00 00 0F cf  00 00  00  00  00  00  00  00  00  00  00  00  00  00 
39 01 00 00 00 00 02 00  90
39 01 00 00 00 00 0F cf  00 00  00  00  00  00  00  00  00  00  00  00  00  00 
39 01 00 00 00 00 02 00  a0
39 01 00 00 00 00 0F cf  00 00  00  00  00  00  00  00  00  00  00  00  00  00 
39 01 00 00 00 00 02 00  b0
39 01 00 00 00 00 0F cf  00 00  00  00  00  00  00  00  00  00  00  00  00  00 
39 01 00 00 00 00 02 00  c0
39 01 00 00 00 00 0C cf  01 01  20  20  00  00  01  81  00  03  08 
39 01 00 00 00 00 02 00  00
39 01 00 00 00 00 03 d8  bc bc 
39 01 00 00 00 00 02 00  00
39 01 00 00 00 00 02 d9  53//vcom
39 01 00 00 00 00 02 00  00
39 01 00 00 00 00 11 E1  0a 14  1a  0E  07  0F  0B  0A  04  06  0C  08  0F  10  0b  06 
39 01 00 00 00 00 02 00  00
39 01 00 00 00 00 11 E2  0a 15  1a  0E  07  0F  0B  0A  04  07  0C  08  0F  10  0b  06 

39 01 00 00 00 00 02 00  A0
39 01 00 00 00 00 0D D6  01 00  01  00  01  00  01  b3  01  f3  01  b3 
39 01 00 00 00 00 02 00  B0
39 01 00 00 00 00 0D D6  01 b3  01  b3  01  b3  01  b3  01  b3  01  b3 
39 01 00 00 00 00 02 00  C0
39 01 00 00 00 00 0D D6  1e 11  00  77  11  77  a2  11  77  77  11  77 
39 01 00 00 00 00 02 00  D0
39 01 00 00 00 00 07 D6  77 11  77  77  11  77 
39 01 00 00 00 00 02 00  E0
39 01 00 00 00 00 0D D6  1e 11  3c  3c  11  3c  51  11  3c  3c  11  3c 
39 01 00 00 00 00 02 00  F0
39 01 00 00 00 00 07 D6  3c 11  3c  3c  11  3c 
39 01 00 00 00 00 02 00  90             
39 01 00 00 00 00 02 D6  80 
39 01 00 00 00 00 02 00  81             
39 01 00 00 00 00 03 D6  03 FF    //
39 01 00 00 00 00 02 00  A0 
39 01 00 00 00 00 02 C1  02  // Disable time-out function 
39 01 00 00 00 00 02 00  00
39 01 00 00 00 00 04 ff  ff ff  ff             
39 01 00 00 00 00 02 55  90 // CE Medium
05 01 00 00 78 00 02 11 00 
05 01 00 00 78 00 02 29 00];

	};
};
