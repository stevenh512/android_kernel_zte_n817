/* Copyright (c) 2013, The Linux Foundation. All rights reserved.
 *
 * This program is free software; you can redistribute it and/or modify
 * it under the terms of the GNU General Public License version 2 and
 * only version 2 as published by the Free Software Foundation.
 *
 * This program is distributed in the hope that it will be useful,
 * but WITHOUT ANY WARRANTY; without even the implied warranty of
 * MERCHANTABILITY or FITNESS FOR A PARTICULAR PURPOSE.  See the
 * GNU General Public License for more details.
 */

/*---------------------------------------------------------------------------
 * This file is autogenerated file using gcdb parser. Please do not edit it.
 * Update input XML file to add a new entry or update variable in this file
 * VERSION = "1.0"
 *---------------------------------------------------------------------------*/
&mdss_mdp {
	dsi_otm8019a_wvga_video: qcom,mdss_dsi_otm8019a_wvga_video {
		qcom,mdss-dsi-panel-name = "Orise OTM8019A WVGA Video mode DSI panel";
		zte,lcd-proc-panel-name = "zte(otm8019a)_480*800_4P0Inch";
		qcom,mdss-dsi-panel-controller = <&mdss_dsi0>;
		qcom,mdss-dsi-panel-type = "dsi_video_mode";
		qcom,mdss-dsi-panel-destination = "display_1";
		qcom,cont-splash-enabled;
		qcom,mdss-dsi-panel-framerate = <59>;
		qcom,mdss-dsi-virtual-channel-id = <0>;
		qcom,mdss-dsi-stream = <0>;
		qcom,mdss-dsi-panel-width = <480>;
		qcom,mdss-dsi-panel-height = <800>;
		qcom,mdss-dsi-h-front-porch = <16>;
		qcom,mdss-dsi-h-back-porch = <20>;
		qcom,mdss-dsi-h-pulse-width = <2>;
		qcom,mdss-dsi-h-sync-skew = <0>;
		qcom,mdss-dsi-v-back-porch = <12>;
		qcom,mdss-dsi-v-front-porch = <8>;
		qcom,mdss-dsi-v-pulse-width = <4>;
		qcom,mdss-dsi-h-left-border = <0>;
		qcom,mdss-dsi-h-right-border = <0>;
		qcom,mdss-dsi-v-top-border = <0>;
		qcom,mdss-dsi-v-bottom-border = <0>;
		qcom,mdss-dsi-bpp = <24>;
		qcom,mdss-dsi-color-order = <0>;
		qcom,mdss-dsi-underflow-color = <0xff>;
		qcom,mdss-dsi-border-color = <0>;
		qcom,mdss-dsi-on-command = [15 01 00 00 00 00 02 00 00
	            29 01 00 00 00 00 04 FF 80 19 01
	            15 01 00 00 00 00 02 00 80
	            29 01 00 00 00 00 03 FF 80 19
	            15 01 00 00 00 00 02 00 B4
	            15 01 00 00 00 00 02 C0 70
	            15 01 00 00 00 00 02 00 81
	            15 01 00 00 00 00 02 C5 66
	            15 01 00 00 00 00 02 00 82
	            15 01 00 00 00 00 02 C5 B0
	            15 01 00 00 00 00 02 00 90
	            29 01 00 00 00 00 03 C5 4E 76
	            15 01 00 00 00 00 02 00 00
	            29 01 00 00 00 00 03 D8 6F 6f
	            15 01 00 00 00 00 02 00 00
	            15 01 00 00 00 00 02 D9 4d
	            15 01 00 00 00 00 02 00 81
	            15 01 00 00 00 00 02 C1 33
	            15 01 00 00 00 00 02 00 A1
	            15 01 00 00 00 00 02 C1 08
	            15 01 00 00 00 00 02 00 81
	            15 01 00 00 00 00 02 C4 83
	            15 01 00 00 00 00 02 00 B1
	            15 01 00 00 00 00 02 C5 A9
	            15 01 00 00 00 00 02 00 93
	            15 01 00 00 00 00 02 C5 03
	            15 01 00 00 00 00 02 00 92
	            15 01 00 00 00 00 02 B3 40
	            15 01 00 00 00 00 02 00 90
	            15 01 00 00 00 00 02 B3 02
	            15 01 00 00 00 00 02 00 80
	            29 01 00 00 00 00 0a C0 00 58 00 15 15 00 58 15 15
	            15 01 00 00 00 00 02 00 90
	            29 01 00 00 00 00 07 C0 00 15 00 00 00 04
	            15 01 00 00 00 00 02 00 80
	            29 01 00 00 00 00 0d CE 8B 03 0a 8A 03 0a 89 03 0a 88 03 0a
	            15 01 00 00 00 00 02 00 A0
	            29 01 00 00 00 00 0f CE 38 07 83 54 8c 0a 00 38 06 83 55 8c 0a 00
	            15 01 00 00 00 00 02 00 B0
	            29 01 00 00 00 00 0f CE 38 05 83 56 8c 0a 00 38 04 83 57 8c 0a 00
	            15 01 00 00 00 00 02 00 C0
	            29 01 00 00 00 00 0f CE 38 03 83 58 8c 0a 00 38 02 83 59 8c 0a 00
	            15 01 00 00 00 00 02 00 D0
	            29 01 00 00 00 00 0f CE 38 01 83 5A 8c 0a 00 38 00 83 5B 8c 0a 00
	            15 01 00 00 00 00 02 00 C0
	            29 01 00 00 00 00 0b CF 3d 3d 0a 0a 00 00 01 81 00 05
	            15 01 00 00 00 00 02 00 90
	            29 01 00 00 00 00 10 CB 00 00 00 00 00 00 00 00 00 00 00 00 00 00 00
	            15 01 00 00 00 00 02 00 A0
	            15 01 00 00 00 00 02 CB 00
	            15 01 00 00 00 00 02 00 A5
	            29 01 00 00 00 00 0b CB 00 00 00 00 00 00 00 00 00 00
	            15 01 00 00 00 00 02 00 B0
	            29 01 00 00 00 00 07 CB 00 00 00 00 00 00
	            15 01 00 00 00 00 02 00 C0
	            29 01 00 00 00 00 10 CB 15 15 15 15 15 15 15 15 15 15 00 00 00 00 00
	            15 01 00 00 00 00 02 00 D0
	            15 01 00 00 00 00 02 CB 00
	            15 01 00 00 00 00 02 00 D5
	            29 01 00 00 00 00 0b CB 00 00 00 00 00 00 15 15 15 15
	            15 01 00 00 00 00 02 00 E0
	            29 01 00 00 00 00 07 CB 15 15 15 15 15 15
	            15 01 00 00 00 00 02 00 80
	            29 01 00 00 00 00 0b CC 26 25 21 22 0C 0A 10 0E 02 04
	            15 01 00 00 00 00 02 00 90
	            29 01 00 00 00 00 10 CC 00 00 00 00 00 00 00 00 00 00 00 00 00 00 00
	            15 01 00 00 00 00 02 00 A0
	            29 01 00 00 00 00 0c CC 00 03 01 0D 0F 09 0B 22 21 25 26
	            15 01 00 00 00 00 02 00 B0
	            29 01 00 00 00 00 0b CC 25 26 21 22 0D 0F 09 0B 03 01
	            15 01 00 00 00 00 02 00 C0
	            29 01 00 00 00 00 07 CC 00 00 00 00 00 00
	            15 01 00 00 00 00 02 00 CA
	            29 01 00 00 00 00 06 CC 00 00 00 00 00
	            15 01 00 00 00 00 02 00 D0
	            29 01 00 00 00 00 0c CC 00 02 04 0C 0A 10 0E 22 21 26 25
	            15 01 00 00 00 00 02 00 00
	            29 01 00 00 00 00 15 E1 00 05 16 24 36 49 56 87 77 8d 79 68 80 6a 6f 67 60 50 47 00
	            15 01 00 00 00 00 02 00 00
	            29 01 00 00 00 00 15 E2 00 05 16 24 36 49 56 87 77 8d 79 67 7f 6a 6f 67 5f 50 47 00
	            15 01 00 00 00 00 02 00 80
	            15 01 00 00 00 00 02 C4 30
	            15 01 00 00 00 00 02 00 98
	            15 01 00 00 00 00 02 C0 00
	            15 01 00 00 00 00 02 00 a9
	            15 01 00 00 00 00 02 C0 0A
	            15 01 00 00 00 00 02 00 b0
	            29 01 00 00 00 00 07 C1 20 00 00 00 02 01
	            15 01 00 00 00 00 02 00 e1
	            29 01 00 00 00 00 03 C0 40 30
	            15 01 00 00 00 00 02 00 80
	            29 01 00 00 00 00 03 C1 03 33
	            15 01 00 00 00 00 02 00 A0
	            15 01 00 00 00 00 02 C1 e8
	            15 01 00 00 00 00 02 00 90
	            15 01 00 00 00 00 02 b6 b4
	            15 01 00 00 00 00 02 00 83
	            15 01 00 00 0a 00 02 C5 01
	            15 01 00 00 00 00 02 00 00
	            15 01 00 00 00 00 02 fb 01
	            15 01 00 00 00 00 02 00 00
	            29 01 00 00 00 00 04 FF FF FF FF
	            15 01 00 00 00 00 02 11 00
	            15 01 00 00 78 00 02 29 00];
		qcom,mdss-dsi-off-command = [05 01 00 00 78 00 02 28 00
	             05 01 00 00 78 00 02 10 00];
		qcom,mdss-dsi-on-command-state = "dsi_lp_mode";
		qcom,mdss-dsi-off-command-state = "dsi_lp_mode";
		qcom,mdss-dsi-h-sync-pulse = <1>;
		qcom,mdss-dsi-traffic-mode = "burst_mode";
		qcom,mdss-dsi-lane-map = "lane_map_0123";
		qcom,mdss-dsi-bllp-eof-power-mode;
		qcom,mdss-dsi-bllp-power-mode;
		qcom,mdss-dsi-lane-0-state;
		qcom,mdss-dsi-lane-1-state;
		qcom,mdss-dsi-panel-timings = [5D 12 0C 00 34 36 10 16 0F 03 04 00];
		qcom,mdss-dsi-t-clk-post = <0x05>;
 		qcom,mdss-dsi-t-clk-pre = <0x21>;
		qcom,mdss-dsi-bl-min-level = <10>;
		qcom,mdss-dsi-bl-max-level = <255>;
		qcom,mdss-dsi-dma-trigger = "trigger_sw";
		qcom,mdss-dsi-mdp-trigger = "none";
		qcom,mdss-dsi-bl-pmic-control-type = "bl_ctrl_wled";
		qcom,mdss-dsi-reset-sequence = <1 2>, <0 1>, <1 6>;
	};
};
