/* Copyright (c) 2013, The Linux Foundation. All rights reserved.
 *
 * This program is free software; you can redistribute it and/or modify
 * it under the terms of the GNU General Public License version 2 and
 * only version 2 as published by the Free Software Foundation.
 *
 * This program is distributed in the hope that it will be useful,
 * but WITHOUT ANY WARRANTY; without even the implied warranty of
 * MERCHANTABILITY or FITNESS FOR A PARTICULAR PURPOSE.  See the
 * GNU General Public License for more details.
 */

/*---------------------------------------------------------------------------
 * This file is autogenerated file using gcdb parser. Please do not edit it.
 * Update input XML file to add a new entry or update variable in this file
 * VERSION = "1.0"
 *---------------------------------------------------------------------------*/
&mdss_mdp {
	dsi_lead_qhd_vid: qcom,zte-hsd-otm9608-qhd-video {
		qcom,mdss-dsi-panel-name = "Lead qHD hsd otm9608 video mode dsi panel";
		qcom,mdss-pan-physical-height-dimension = <110>;		
		qcom,mdss-pan-physical-width-dimension = <62>;		
		zte,lcd-proc-panel-name = "zteHSD(OTM9608)_540*960_5Inch_900";
		qcom,cont-splash-enabled;
		qcom,mdss-dsi-panel-controller = <&mdss_dsi0>;
		qcom,mdss-dsi-panel-type = "dsi_video_mode";
		qcom,mdss-dsi-panel-destination = "display_1";
		qcom,mdss-dsi-panel-framerate = <60>;
		qcom,mdss-dsi-virtual-channel-id = <0>;
		qcom,mdss-dsi-stream = <0>;
		qcom,mdss-dsi-panel-width = <540>;
		qcom,mdss-dsi-panel-height = <960>;
		qcom,mdss-dsi-h-front-porch = <48>;
		qcom,mdss-dsi-h-back-porch = <96>;
		qcom,mdss-dsi-h-pulse-width = <96>;
		qcom,mdss-dsi-h-sync-skew = <0>;
		qcom,mdss-dsi-v-front-porch = <9>;
		qcom,mdss-dsi-v-pulse-width = <3>;
		qcom,mdss-dsi-v-back-porch = <13>;
		qcom,mdss-dsi-h-left-border = <0>;
		qcom,mdss-dsi-h-right-border = <0>;
		qcom,mdss-dsi-v-top-border = <0>;
		qcom,mdss-dsi-v-bottom-border = <0>;
		qcom,mdss-dsi-bpp = <24>;
		qcom,mdss-dsi-color-order = <0>;
		qcom,mdss-dsi-underflow-color = <0xff>;
		qcom,mdss-dsi-border-color = <0>;
		qcom,mdss-dsi-on-command = [39 01 00 00 00 00 02 00 00
39 01 00 00 00 00 04 FF 96 08 01
39 01 00 00 00 00 02 00 80
39 01 00 00 00 00 03 FF 96 08
39 01 00 00 00 00 02 00 B1
39 01 00 00 00 00 03 B0 03 06
39 01 00 00 00 00 02 00 00
39 01 00 00 00 00 02 A0 00
39 01 00 00 00 00 02 00 80
39 01 00 00 00 00 06 B3 00 00 20 00 00
39 01 00 00 00 00 02 00 c0
39 01 00 00 00 00 02 B3 09
39 01 00 00 00 00 02 00 80
39 01 00 00 00 00 0a C0 00 48 00 08 10 00 48 08 10
39 01 00 00 00 00 02 00 92
39 01 00 00 00 00 05 C0 00 10 00 13
39 01 00 00 00 00 02 00 A0
39 01 00 00 00 00 02 C0 00
39 01 00 00 00 00 02 00 a2
39 01 00 00 00 00 04 C0 0C 05 02
39 01 00 00 00 00 02 00 b3
39 01 00 00 00 00 03 C0 00 50
39 01 00 00 00 00 02 00 81
39 01 00 00 00 00 02 C1 66
39 01 00 00 00 00 02 00 80
39 01 00 00 00 00 03 C4 00 80
39 01 00 00 00 00 02 00 88
39 01 00 00 00 00 02 C4 40
39 01 00 00 00 00 02 00 a0
39 01 00 00 00 00 09 C4 33 09 90 2B 33 09 90 54
39 01 00 00 00 00 02 00 80
39 01 00 00 00 00 05 C5 08 00 A0 11
39 01 00 00 00 00 02 00 90
39 01 00 00 00 00 08 C5 96 76 06 76 33 33 34
39 01 00 00 00 00 02 00 a0
39 01 00 00 00 00 08 C5 96 76 06 76 33 33 34
39 01 00 00 00 00 02 00 B0
39 01 00 00 00 00 03 C5 04 A8
39 01 00 00 00 00 02 00 80
39 01 00 00 00 00 02 C6 64
39 01 00 00 00 00 02 00 b0
39 01 00 00 00 00 06 C6 03 10 00 1F 12
39 01 00 00 00 00 02 00 00
39 01 00 00 00 00 02 D0 40
39 01 00 00 00 00 02 00 00
39 01 00 00 00 00 03 D1 00 00
39 01 00 00 00 00 02 00 b7
39 01 00 00 00 00 02 B0 10
39 01 00 00 00 00 02 00 c0
39 01 00 00 00 00 03 B0 55 50
39 01 00 00 00 00 02 00 80
39 01 00 00 00 00 0b CB 00 00 00 00 00 00 00 00 00 00
39 01 00 00 00 00 02 00 90
39 01 00 00 00 00 10 CB 00 00 00 00 00 00 00 00 00 00 00 00 00 00 00
39 01 00 00 00 00 02 00 A0
39 01 00 00 00 00 10 CB 00 00 00 00 00 00 00 00 00 00 00 00 00 00 00
39 01 00 00 00 00 02 00 B0
39 01 00 00 00 00 0b CB 00 00 00 00 00 00 00 00 00 00
39 01 00 00 00 00 02 00 C0
39 01 00 00 00 00 10 CB 04 04 04 04 00 04 00 04 00 04 00 04 04 04 00
39 01 00 00 00 00 02 00 D0
39 01 00 00 00 00 10 CB 00 00 00 00 00 04 04 04 04 00 04 00 04 00 04
39 01 00 00 00 00 02 00 E0
39 01 00 00 00 00 0b CB 00 04 04 04 00 00 00 00 00 00
39 01 00 00 00 00 02 00 F0
39 01 00 00 00 00 0b CB 00 CC CC 00 00 00 CC CC 0F 00
39 01 00 00 00 00 02 00 80
39 01 00 00 00 00 0b CC 26 25 21 22 00 0C 00 0A 00 10
39 01 00 00 00 00 02 00 90
39 01 00 00 00 00 10 CC 00 0E 02 04 00 00 00 00 00 00 26 25 21 22 00
39 01 00 00 00 00 02 00 A0
39 01 00 00 00 00 10 CC 0B 00 09 00 0F 00 0D 01 03 00 00 00 00 00 00
39 01 00 00 00 00 02 00 B0
39 01 00 00 00 00 0b CC 25 26 21 22 00 0D 00 0F 00 09
39 01 00 00 00 00 02 00 C0
39 01 00 00 00 00 10 CC 00 0B 03 01 00 00 00 00 00 00 25 26 21 22 00
39 01 00 00 00 00 02 00 D0
39 01 00 00 00 00 10 CC 0E 00 10 00 0A 00 0C 04 02 00 00 00 00 00 00
39 01 00 00 00 00 02 00 80
39 01 00 00 00 00 0d CE 8A 03 28 89 03 28 88 03 28 87 03 28
39 01 00 00 00 00 02 00 90
39 01 00 00 00 00 0f CE F0 00 00 F0 00 00 F0 00 00 F0 00 00 00 00
39 01 00 00 00 00 02 00 A0
39 01 00 00 00 00 0f CE 38 06 03 C1 00 18 00 38 05 03 C2 00 18 00
39 01 00 00 00 00 02 00 B0
39 01 00 00 00 00 0f CE 38 04 03 C3 00 18 00 38 03 03 C4 00 18 00
39 01 00 00 00 00 02 00 C0
39 01 00 00 00 00 0f CE 38 02 03 C5 00 18 00 38 01 03 C6 00 18 00
39 01 00 00 00 00 02 00 D0
39 01 00 00 00 00 0f CE 38 00 03 C7 00 18 00 30 00 03 C8 00 18 00
39 01 00 00 00 00 02 00 C0
39 01 00 00 00 00 02 CF 02
39 01 00 00 00 00 02 00 88
39 01 00 00 00 00 02 c4 40
39 01 00 00 00 00 02 00 c7
39 01 00 00 00 00 02 cf 00
39 01 00 00 00 00 02 00 00
39 01 00 00 00 00 03 d8 87 87
39 01 00 00 00 00 02 00 00
39 01 00 00 00 00 02 d9 3D
39 01 00 00 00 00 02 00 00
39 01 00 00 00 00 11 E1 02 0D 13 0E 07 0D 0A 07 06 09 0F 07 0E 0C 09 06
39 01 00 00 00 00 02 00 00
39 01 00 00 00 00 11 E2 02 0D 13 0E 07 0E 0A 07 06 09 0E 07 0E 0C 09 06
39 01 00 00 00 00 02 00 00
39 01 00 00 00 00 04 FF FF FF FF
05 01 00 00 78 00 02 11 00
05 01 00 00 0A 00 02 29 00];
		qcom,mdss-dsi-off-command = [05 01 00 00 0a 00 02 28 00
					05 01 00 00 78 00 02 10 00];
		qcom,mdss-dsi-on-command-state = "dsi_lp_mode";
		qcom,mdss-dsi-off-command-state = "dsi_lp_mode";
		qcom,mdss-dsi-h-sync-pulse = <1>;
		qcom,mdss-dsi-traffic-mode = "burst_mode";
		qcom,mdss-dsi-lane-map = "lane_map_3012";
		qcom,mdss-dsi-bllp-eof-power-mode;
		qcom,mdss-dsi-bllp-power-mode;
		qcom,mdss-dsi-lane-0-state;
		qcom,mdss-dsi-lane-1-state;
		qcom,mdss-dsi-panel-timings = [97 23 17 00 4B 53 1C 27 27 03 04 00];
		qcom,mdss-dsi-t-clk-post = <0x04>;
		qcom,mdss-dsi-t-clk-pre = <0x1b>;
		qcom,mdss-dsi-bl-min-level = <1>;
		qcom,mdss-dsi-bl-max-level = <31>;
		qcom,mdss-dsi-dma-trigger = "trigger_sw";
		qcom,mdss-dsi-mdp-trigger = "none";
		qcom,mdss-dsi-bl-cmd-gpio =  <&msmgpio 89 0>;
		qcom,mdss-dsi-bl-pmic-control-type = "bl_ctrl_gpio";
		qcom,mdss-dsi-reset-sequence = <1 20>, <0 20>, <1 20>;

	};
};
