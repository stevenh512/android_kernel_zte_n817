/* Copyright (c) 2013, The Linux Foundation. All rights reserved.
 *
 * This program is free software; you can redistribute it and/or modify
 * it under the terms of the GNU General Public License version 2 and
 * only version 2 as published by the Free Software Foundation.
 *
 * This program is distributed in the hope that it will be useful,
 * but WITHOUT ANY WARRANTY; without even the implied warranty of
 * MERCHANTABILITY or FITNESS FOR A PARTICULAR PURPOSE.  See the
 * GNU General Public License for more details.
 */

/*---------------------------------------------------------------------------
 * This file is autogenerated file using gcdb parser. Please do not edit it.
 * Update input XML file to add a new entry or update variable in this file
 * VERSION = "1.0"
 *---------------------------------------------------------------------------*/
&mdss_mdp {
	dsi_boe_fwvga_vid: qcom,zte-boe-otm8019a-fwvga-video {
		qcom,mdss-dsi-panel-name = "zteBOE(otm8019a)CPT_480*854_4P5Inch";
		qcom,mdss-pan-physical-height-dimension = <99>;		
		qcom,mdss-pan-physical-width-dimension = <56>;		
		zte,lcd-proc-panel-name = "zteBOE(otm8019a)_480*854_4P5Inch";
		qcom,cont-splash-enabled;
		qcom,mdss-dsi-panel-controller = <&mdss_dsi0>;
		qcom,mdss-dsi-panel-type = "dsi_video_mode";
		qcom,mdss-dsi-panel-destination = "display_1";
		qcom,mdss-dsi-panel-framerate = <60>;
		qcom,mdss-dsi-virtual-channel-id = <0>;
		qcom,mdss-dsi-stream = <0>;
		qcom,mdss-dsi-panel-width = <480>;
		qcom,mdss-dsi-panel-height = <854>;
		qcom,mdss-dsi-h-front-porch = <48>;
		qcom,mdss-dsi-h-back-porch = <96>;
		qcom,mdss-dsi-h-pulse-width = <96>;
		qcom,mdss-dsi-h-sync-skew = <0>;
		qcom,mdss-dsi-v-front-porch = <9>;
		qcom,mdss-dsi-v-pulse-width = <8>;
		qcom,mdss-dsi-v-back-porch = <13>;
		qcom,mdss-dsi-h-left-border = <0>;
		qcom,mdss-dsi-h-right-border = <0>;
		qcom,mdss-dsi-v-top-border = <0>;
		qcom,mdss-dsi-v-bottom-border = <0>;
		qcom,mdss-dsi-bpp = <24>;
		qcom,mdss-dsi-color-order = <0>;
		qcom,mdss-dsi-underflow-color = <0xff>;
		qcom,mdss-dsi-border-color = <0>;
		qcom,mdss-dsi-on-command = [
39 01 00 00 00 00 02 00 00
39 01 00 00 00 00 04 ff 80 19 01
39 01 00 00 00 00 02 00 80
39 01 00 00 00 00 03 ff 80 19
39 01 00 00 00 00 02 00 03
39 01 00 00 00 00 02 ff 01
39 01 00 00 00 00 02 00 90
39 01 00 00 00 00 02 b3 02
39 01 00 00 00 00 02 00 92
39 01 00 00 00 00 02 b3 45
39 01 00 00 00 00 02 00 a6
39 01 00 00 00 00 03 b3 20 01
39 01 00 00 00 00 02 00 a3
39 01 00 00 00 00 02 c0 1b
39 01 00 00 00 00 02 00 b4
39 01 00 00 00 00 02 c0 00
39 01 00 00 00 00 02 00 81
39 01 00 00 00 00 02 c4 04
39 01 00 00 00 00 02 00 80
39 01 00 00 00 00 02 c5 03
39 01 00 00 00 00 02 00 90
39 01 00 00 00 00 07 c0 00 15 00 00 00 03
39 01 00 00 00 00 02 00 82
39 01 00 00 00 00 02 c5 b0
39 01 00 00 00 00 02 00 90
39 01 00 00 00 00 06 c5 4e 2b 04 7b 33
39 01 00 00 00 00 02 00 00
39 01 00 00 00 00 03 d8 65 65
39 01 00 00 00 00 02 00 00
39 01 00 00 00 00 02 d9 58
39 01 00 00 00 00 02 00 80
39 01 00 00 00 00 03 c1 03 33
39 01 00 00 00 00 02 00 80
39 01 00 00 00 00 07 CE 86 01 00 85 01 00
39 01 00 00 00 00 02 00 A0
39 01 00 00 00 00 0f CE 18 05 03 5B 00 00 00 18 04 03 5C 00 00 00
39 01 00 00 00 00 02 00 B0
39 01 00 00 00 00 0f CE 18 03 03 5D 00 00 00 18 02 03 5E 00 00 00
39 01 00 00 00 00 02 00 80
39 01 00 00 00 00 0f CF 00 00 00 00 00 00 00 00 00 00 00 00 00 00
39 01 00 00 00 00 02 00 90
39 01 00 00 00 00 0f CF 00 00 00 00 00 00 00 00 00 00 00 00 00 00
39 01 00 00 00 00 02 00 a0
39 01 00 00 00 00 0f CF 00 00 00 00 00 00 00 00 00 00 00 00 00 00
39 01 00 00 00 00 02 00 b0
39 01 00 00 00 00 0f CF 00 00 00 00 00 00 00 00 00 00 00 00 00 00
39 01 00 00 00 00 02 00 c0
39 01 00 00 00 00 0b CF 01 01 20 20 00 00 01 00 00 00
39 01 00 00 00 00 02 00 d0
39 01 00 00 00 00 02 cf 00
39 01 00 00 00 00 02 00 90
39 01 00 00 00 00 10 CB 00 00 00 00 00 00 00 00 00 00 00 00 00 00 00
39 01 00 00 00 00 02 00 a0
39 01 00 00 00 00 02 cb 00
39 01 00 00 00 00 02 00 a5
39 01 00 00 00 00 0b CB 00 00 00 00 00 00 00 00 00 00
39 01 00 00 00 00 02 00 b0
39 01 00 00 00 00 07 CB 00 00 00 00 00 00
39 01 00 00 00 00 02 00 c0
39 01 00 00 00 00 10 CB 00 01 01 01 01 01 00 00 00 00 00 00 00 00 00
39 01 00 00 00 00 02 00 d0
39 01 00 00 00 00 02 cb 00
39 01 00 00 00 00 02 00 d5
39 01 00 00 00 00 0b CB 00 00 00 00 00 00 00 00 00 00
39 01 00 00 00 00 02 00 e0
39 01 00 00 00 00 07 CB 01 01 01 01 01 00
39 01 00 00 00 00 02 00 80
39 01 00 00 00 00 0b CC 00 26 09 0B 01 25 00 00 00 00
39 01 00 00 00 00 02 00 90
39 01 00 00 00 00 07 CC 00 00 00 00 00 00
39 01 00 00 00 00 02 00 9a
39 01 00 00 00 00 06 CC 00 00 00 00 00
39 01 00 00 00 00 02 00 a0
39 01 00 00 00 00 0c CC 00 00 00 00 00 25 02 0C 0A 26 00
39 01 00 00 00 00 02 00 b0
39 01 00 00 00 00 0b CC 00 25 0C 0A 02 26 00 00 00 00
39 01 00 00 00 00 02 00 c0
39 01 00 00 00 00 07 CC 00 00 00 00 00 00
39 01 00 00 00 00 02 00 ca
39 01 00 00 00 00 06 CC 00 00 00 00 00
39 01 00 00 00 00 02 00 d0
39 01 00 00 00 00 0c CC 00 00 00 00 00 26 01 0D 0F 25 00
39 01 00 00 00 00 02 00 00
39 01 00 00 00 00 15 E1 07 07 10 21 38 50 60 99 86 9B 6D 5C 76 63 69 62 5B 53 49 15
39 01 00 00 00 00 02 00 00
39 01 00 00 00 00 15 E2 07 07 10 21 38 50 60 99 86 9B 6D 5C 76 63 69 62 5B 53 49 15
39 01 00 00 00 00 02 00 80
39 01 00 00 00 00 02 c4 30
39 01 00 00 00 00 02 00 98
39 01 00 00 00 00 02 c0 00
39 01 00 00 00 00 02 00 a9
39 01 00 00 00 00 02 c0 06
39 01 00 00 00 00 02 00 b0
39 01 00 00 00 00 04 C1 20 00 00
39 01 00 00 00 00 02 00 e1
39 01 00 00 00 00 03 C0 40 18
39 01 00 00 00 00 02 00 a0
39 01 00 00 00 00 02 c1 e8
39 01 00 00 00 00 02 00 90
39 01 00 00 00 00 02 b6 b4
39 01 00 00 00 00 02 00 98
39 01 00 00 00 00 02 c0 00
39 01 00 00 00 00 02 00 a9
39 01 00 00 00 00 02 c0 0a
39 01 00 00 00 00 02 00 b0
39 01 00 00 00 00 04 c1 20 00 00
39 01 00 00 00 00 02 c0 e1
39 01 00 00 00 00 03 c0 40 30
39 01 00 00 00 00 02 00 80
39 01 00 00 00 00 02 d6 a8
39 01 00 00 00 00 02 00 b0
39 01 00 00 00 00 02 ca 08
39 01 00 00 00 00 02 00 b3
39 01 00 00 00 00 02 ca 50
39 01 00 00 00 00 02 00 00
39 01 00 00 00 00 04 ff ff ff ff
39 01 00 00 05 00 02 51 00 
39 01 00 00 05 00 02 53 00 
39 01 00 00 05 00 02 55 00
05 01 00 00 78 00 02 11 00
05 01 00 00 0a 00 02 29 00
];
		qcom,mdss-dsi-off-command = [05 01 00 00 0a 00 02 28 00
					05 01 00 00 78 00 02 10 00];
		qcom,mdss-dsi-on-command-state = "dsi_lp_mode";
		qcom,mdss-dsi-off-command-state = "dsi_hs_mode";
		qcom,mdss-dsi-h-sync-pulse = <1>;
		//qcom,mdss-dsi-traffic-mode = "burst_mode";
		qcom,mdss-dsi-lane-map = "lane_map_3012";
		qcom,mdss-dsi-bllp-eof-power-mode;
		qcom,mdss-dsi-bllp-power-mode;
		qcom,mdss-dsi-lane-0-state;
		qcom,mdss-dsi-lane-1-state;
		/*add for cmd mode start 20140410*/
               qcom,mdss-dsi-te-pin-select = <1>;
               qcom,mdss-dsi-wr-mem-start = <0x2c>;
               qcom,mdss-dsi-te-dcs-command = <1>;
               qcom,mdss-dsi-te-check-enable;
               qcom,mdss-dsi-te-using-te-pin;
               /*add for cmd mode end 20140410*/
		qcom,mdss-dsi-panel-timings = [87 1c 12 00 42 44 18 20 17 03 04 00];
		qcom,mdss-dsi-t-clk-post = <0x07>;
		qcom,mdss-dsi-t-clk-pre = <0x0d>;
		qcom,mdss-dsi-bl-min-level = <1>;
		qcom,mdss-dsi-bl-max-level = <31>;
		qcom,mdss-dsi-dma-trigger = "trigger_sw";
		qcom,mdss-dsi-mdp-trigger = "none";
		qcom,mdss-dsi-reset-sequence = <1 20>, <0 20>, <1 20>;
		qcom,mdss-dsi-bl-cmd-gpio =  <&msmgpio 89 0>;
		qcom,mdss-dsi-bl-pmic-control-type = "bl_ctrl_gpio";
	};
};
