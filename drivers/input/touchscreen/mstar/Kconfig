## drivers/input/touchscreen/mstar/Kconfig
```kconfig
#
# MSTAR Touchscreen driver
#
config TOUCHSCREEN_MSG22XX
        tristate "M-STAR Touch MSG22xx"
        depends on TOUCHSCREEN_MSTAR
        default y
        help
          Say Y here if you have a M-STAR MSG22xx touchscreen.

          If unsure, say N.
```

## drivers/irda/Kconfig
```kconfig
#
# external IRDA devices
#

menuconfig EXTERNAL_IRDA
	bool "external IRDA devices support"
	depends on HAS_IOMEM
	help
	  This supports external IRDA devices.

if EXTERNAL_IRDA

config ICE40_IRDA
	tristate "ICE40 IRDA device driver support"
	depends on EXTERNAL_IRDA && SPI
	help
	  This supports ICE40 SPI protocol drivers.

endif # EXTERNAL_IRDA
```

## drivers/staging/zte_ftm/Kconfig
```kconfig
#
# Created by ZTE_BOOT_JIA_20120803 jia.jia
#

menu "ZTE FTM"

config ZTE_FTM
    depends on ARCH_MSM8610
	bool "ZTE FTM Driver"
	default n
	help
	  Enable support for FTM driver needed on the ZTE platform

endmenu
```
